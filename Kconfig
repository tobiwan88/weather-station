## Kconfig
```kconfig
# SPDX-License-Identifier: Apache-2.0
#
# Root Kconfig for the weather-station module.
# Re-sources all library Kconfig files.

rsource "lib/Kconfig"
```

## dts/bindings/fake,voc.yaml
```yaml
description: |
  Fake VOC (volatile organic compound) air quality sensor for native_sim and testing.

  Reports a Bosch-style IAQ (Index for Air Quality) in the range 0–500:
    0–50   Excellent
    51–100  Good
    101–150 Moderate
    151–200 Unhealthy for sensitive groups
    201–300 Unhealthy
    301–500 Very Unhealthy / Hazardous

  Each DT node with this compatible is instantiated as an independent
  software sensor driver. The driver subscribes to sensor_trigger_chan
  and publishes env_sensor_data events on sensor_event_chan.

compatible: "fake,voc"

properties:
  sensor-uid:
    type: int
    required: true
    description: |
      Unique sensor identifier assigned at design time. Must be unique
      across the entire system (both local and remote nodes). Used as
      the identity key in sensor_registry and in env_sensor_data events.

  initial-value-miaq:
    type: int
    required: true
    description: |
      Initial VOC air quality index in milli-IAQ (IAQ × 1000).
      For example, 25000 represents IAQ 25 (Excellent).
      Range: 0 .. 500000
```

## lib/Kconfig
```kconfig
# SPDX-License-Identifier: Apache-2.0

rsource "sensor_event/Kconfig"
rsource "sensor_trigger/Kconfig"
rsource "sensor_registry/Kconfig"
rsource "location_registry/Kconfig"
rsource "config_cmd/Kconfig"
rsource "fake_sensors/Kconfig"
rsource "sntp_sync/Kconfig"
rsource "clock_display/Kconfig"
rsource "lvgl_display/Kconfig"
rsource "http_dashboard/Kconfig"
rsource "sensor_event_log/Kconfig"
rsource "remote_sensor/Kconfig"
rsource "fake_remote_sensor/Kconfig"
```

## lib/clock_display/Kconfig
```kconfig
# SPDX-License-Identifier: Apache-2.0

menuconfig CLOCK_DISPLAY
	bool "Console clock display (HH:MM UTC)"
	help
	  Logs the current wall-clock time as HH:MM UTC every 60 seconds via
	  a delayable work item. Useful as a minimal clock widget for a
	  weather-station console display.
```

## lib/config_cmd/Kconfig
```kconfig
# SPDX-License-Identifier: Apache-2.0

menuconfig CONFIG_CMD
	bool "Configuration command channel (zbus)"
	depends on ZBUS
	help
	  Enables the config_cmd_chan zbus channel. Producers (e.g.
	  http_dashboard) publish config_cmd_event messages; consumers
	  (fake_sensors, sntp_sync) subscribe independently and act on
	  the commands. Producers never call consumers directly.
```

## lib/fake_remote_sensor/Kconfig
```kconfig
# SPDX-License-Identifier: Apache-2.0

menuconfig FAKE_REMOTE_SENSOR
	bool "Fake remote sensor (testing stub transport)"
	select REMOTE_SENSOR
	help
	  Simulates a remote wireless sensor node for end-to-end testing on
	  native_sim without real BLE/LoRa hardware.

	  Implements the remote_transport vtable with proto=FAKE.
	  Shell command "fake_remote trigger" announces a discovery event;
	  the remote_sensor_manager then registers the sensor and begins
	  receiving auto-published synthetic env_sensor_data events.

if FAKE_REMOTE_SENSOR

config FAKE_REMOTE_SENSOR_UID_PREFIX
	hex "UID prefix for fake remote sensors (upper 16 bits)"
	default 0x0F00
	range 0x0100 0xFF00
	help
	  UIDs for fake remote sensors follow the CRC12 derivation:
	    uid = (prefix << 16) | (crc12(addr) << 4) | type_slot
	  Default 0x0F00 reserves the range 0x0F000000–0x0F00FFFF.
	  Must not overlap with other transport prefixes.

config FAKE_REMOTE_SENSOR_AUTO_PUBLISH_MS
	int "Auto-publish interval in milliseconds (0 = disabled)"
	default 5000
	range 0 300000
	help
	  When non-zero, registered fake remote sensors emit synthetic
	  env_sensor_data events at this interval using a k_timer.
	  Set to 0 to publish only on demand via the shell trigger command.

config FAKE_REMOTE_SENSOR_NODE_COUNT
	int "Number of fake remote sensor nodes to simulate"
	default 1
	range 1 4
	help
	  Each simulated node produces TEMPERATURE, HUMIDITY, CO₂, and VOC
	  discovery events (four UIDs per node).

config FAKE_REMOTE_SENSOR_SHELL
	bool "Shell commands for fake remote sensor control"
	default y
	depends on SHELL
	help
	  Adds the "fake_remote" shell command group:
	    fake_remote announce  — publish discovery events for all fake nodes
	    fake_remote publish   — publish one synthetic measurement round
	    fake_remote status    — show fake node state

endif # FAKE_REMOTE_SENSOR
```

## lib/fake_sensors/Kconfig
```kconfig
# SPDX-License-Identifier: Apache-2.0

menuconfig FAKE_SENSORS
	bool "Fake sensor drivers (native_sim / testing)"
	depends on ZBUS
	depends on SENSOR_EVENT
	depends on SENSOR_TRIGGER
	depends on SENSOR_REGISTRY
	help
	  Enables software-emulated sensor drivers for temperature, humidity,
	  CO₂, and VOC (air quality index), instantiated from DT nodes with
	  compatible "fake,temperature", "fake,humidity", "fake,co2", or
	  "fake,voc". Each driver subscribes to sensor_trigger_chan and
	  publishes env_sensor_data events on sensor_event_chan.

	  Useful for native_sim targets and unit testing without real hardware.

if FAKE_SENSORS

config FAKE_SENSORS_AUTO_PUBLISH_MS
	int "Auto-publish interval in milliseconds (0 = disabled)"
	default 0
	help
	  When non-zero, a kernel timer fires at this interval and broadcasts
	  a TRIGGER_SOURCE_TIMER event so all fake sensors self-publish
	  without any external trigger.

config FAKE_SENSORS_SHELL
	bool "Shell commands for fake sensors"
	default y
	depends on SHELL
	help
	  Registers the 'fake_sensors' shell command group with sub-commands:
	    list            — print all registered fake sensors
	    temperature_set — <uid_hex> <mdegC>  set temperature
	    humidity_set    — <uid_hex> <m%RH>   set humidity

config FAKE_SENSORS_JITTER
	bool "Add random jitter to published readings"
	default y
	depends on ENTROPY_GENERATOR || TEST_RANDOM_GENERATOR
	help
	  When enabled, each published reading has a small random offset applied,
	  making values vary slightly around the configured value. The stored
	  value is unaffected; only the published event carries the jitter.

	  Ranges applied (±):
	    Temperature  0.5 °C   (500 milli-°C)
	    Humidity     2 %RH    (2000 milli-%RH)
	    CO2          25 ppm   (25000 milli-ppm)
	    VOC          5 IAQ    (5000 milli-IAQ)

endif # FAKE_SENSORS
```

## lib/location_registry/Kconfig
```kconfig
# SPDX-License-Identifier: Apache-2.0

menuconfig LOCATION_REGISTRY
	bool "Location registry (named locations)"
	help
	  Runtime CRUD for named physical locations. Locations are independent
	  entities that sensors can be assigned to via sensor_registry_meta.
	  Consumers (HTTP dashboard, shell) enumerate locations through this
	  registry rather than relying on compile-time DT properties.

if LOCATION_REGISTRY

config LOCATION_REGISTRY_MAX_LOCATIONS
	int "Maximum number of locations"
	default 16
	range 1 64

config LOCATION_REGISTRY_NAME_LEN
	int "Maximum location name length (bytes, excluding NUL)"
	default 32
	range 4 64

config LOCATION_REGISTRY_SETTINGS
	bool "Persist locations via Zephyr settings subsystem"
	depends on SETTINGS
	help
	  When enabled, location_registry_add() and location_registry_remove()
	  persist the location list via settings_save_one(). A SYS_INIT at
	  APPLICATION 96 reloads saved locations on boot.
	  Settings key prefix: "loc/".

config LOCATION_REGISTRY_SHELL
	bool "Shell commands for location management"
	depends on SHELL
	help
	  Adds the "location" shell command group:
	    location add <name>
	    location remove <name>
	    location list

module = LOCATION_REGISTRY
module-str = LOCATION_REGISTRY
source "subsys/logging/Kconfig.template.log_config"

endif # LOCATION_REGISTRY
```

## lib/lvgl_display/Kconfig
```kconfig
# SPDX-License-Identifier: Apache-2.0

menuconfig LVGL_DISPLAY
	bool "LVGL graphical weather-station display"
	depends on LVGL && DISPLAY && ZBUS && SENSOR_EVENT && ZBUS_RUNTIME_OBSERVERS
	help
	  SDL-backed 320x240 window.  Shows an analog clock on the left panel and
	  data-driven sensor cards on the right panel.  A card is created
	  automatically the first time an event for a (uid, type) pair is received.
	  Subscribes to sensor_event_chan via a zbus listener; uses lv_async_call()
	  for thread-safe LVGL widget updates.
	  SYS_INIT at APPLICATION priority 91 (after LVGL workqueue at 90).

if LVGL_DISPLAY

config LVGL_DISPLAY_FONTS
	bool
	default y
	select LV_FONT_MONTSERRAT_10
	select LV_FONT_MONTSERRAT_14

config LVGL_DISPLAY_MAX_CARDS
	int "Maximum sensor card slots (uid + type pairs)"
	default 16
	range 4 30
	help
	  Upper bound on how many (uid, type) pairs can be tracked.  Each slot
	  uses sizeof(sensor_card) + sizeof(sensor_card_widgets) bytes of static
	  RAM plus LVGL heap for widget objects.

config LVGL_DISPLAY_SENSORS_PER_PAGE
	int "Sensor cards visible per page"
	default 4
	range 1 8
	help
	  The sensor panel shows this many cards at once.  The nav-bar arrow
	  buttons page through additional cards when more are active.
	  Smaller values give each card more vertical space.

choice LVGL_DISPLAY_CARD_STYLE
	prompt "Sensor card visual style"
	default LVGL_DISPLAY_CARD_STYLE_NUMERIC
	help
	  Choose the widget style used for all sensor cards.

config LVGL_DISPLAY_CARD_STYLE_NUMERIC
	bool "Numeric labels only"
	help
	  Icon, sensor name, formatted value and unit displayed as labels.
	  Lowest LVGL heap cost.

config LVGL_DISPLAY_CARD_STYLE_GAUGE
	bool "Arc gauge (lv_arc)"
	help
	  Icon and name on the left; a small arc gauge on the right with the
	  numeric value overlaid.  The arc sweep represents the sensor value
	  relative to a type-specific physical range.

config LVGL_DISPLAY_CARD_STYLE_BAR
	bool "Progress bar (lv_bar)"
	help
	  Numeric labels on the top row and a thin horizontal bar at the
	  bottom of the card indicating the value within its physical range.

endchoice

config LVGL_DISPLAY_SHOW_CLOCK
	bool "Show analog clock in left panel"
	default y
	help
	  When disabled the left panel is hidden and the sensor card container
	  expands to the full 320 px screen width.

config LVGL_DISPLAY_SHOW_BUTTON_ROW
	bool "Show bottom physical-button indicator row (B1..B4)"
	default n
	help
	  Shows the 18 px row of button boxes below the nav bar.  Useful when
	  the target hardware has physical buttons wired to GPIO.

config LVGL_DISPLAY_USE_SENSOR_REGISTRY
	bool "Show sensor display_name from sensor_registry"
	default y
	depends on SENSOR_REGISTRY && SENSOR_REGISTRY_USER_META
	help
	  When enabled, sensor card name labels use the user-settable
	  display_name from sensor_registry rather than a generic type string.

endif # LVGL_DISPLAY
```

## lib/mqtt_publisher/Kconfig
```kconfig
# SPDX-License-Identifier: Apache-2.0

menuconfig MQTT_PUBLISHER
	bool "MQTT sensor data publisher"
	depends on MQTT_LIB
	depends on NET_SOCKETS
	depends on SENSOR_EVENT
	depends on SENSOR_REGISTRY
	depends on SENSOR_REGISTRY_USER_META
	depends on SNTP_SYNC
	select SETTINGS
	select BASE64
	depends on CONFIG_CMD
	help
	  Subscribes to sensor_event_chan and publishes every measurement to an
	  MQTT broker as:
	    topic:   {gw}/{location}/{display_name}/{type}
	    payload: {"time":<epoch_s>,"value":<float>,"unit":"<str>"}

	  Broker host, port, username, password, gateway name, and keepalive are
	  persisted in the settings subsystem under the "config/mqtt/" subtree and
	  can be changed at runtime via shell commands or the HTTP dashboard.
	  Passwords are base64-encoded before storage.

	  Enable with CONFIG_MQTT_PUBLISHER=y; the library self-registers via
	  SYS_INIT.  Runtime configuration is available via the public API
	  (mqtt_publisher_set_broker/auth/gateway_name/enabled, get_config),
	  shell commands, and the HTTP dashboard.

if MQTT_PUBLISHER

config MQTT_PUBLISHER_GATEWAY_NAME
	string "Default gateway name (first MQTT topic segment)"
	default "gateway"

config MQTT_PUBLISHER_BROKER_HOST
	string "Default broker hostname or IP"
	default "mqtt.local"

config MQTT_PUBLISHER_BROKER_PORT
	int "Default broker TCP port"
	default 1883

config MQTT_PUBLISHER_BROKER_USER
	string "Default broker username (empty = no auth)"
	default ""

config MQTT_PUBLISHER_BROKER_PASS
	string "Default broker password"
	default ""

config MQTT_PUBLISHER_KEEPALIVE
	int "MQTT keepalive interval (seconds)"
	default 60

config MQTT_PUBLISHER_STARTUP_DELAY_MS
	int "Initial startup delay before first broker connect (milliseconds)"
	default 0
	help
	  Delay applied once at thread start, before the first connection attempt.
	  Set to a non-zero value (e.g. 500) in test builds to avoid the NSOS
	  epoll EEXIST race on native_sim: the HTTP server registers its sockets
	  in epoll at boot; connecting the MQTT TCP socket concurrently triggers
	  EPOLL_CTL_ADD on an fd that is still registered, causing DUT exit.

config MQTT_PUBLISHER_RECONNECT_MS
	int "Reconnect retry delay (milliseconds)"
	default 5000

config MQTT_PUBLISHER_QUEUE_DEPTH
	int "Event queue depth (events dropped when full)"
	default 64

config MQTT_PUBLISHER_QUEUE_HIGH
	int "Queue watermark for backpressure warning (events)"
	default 48
	help
	  When the queue fills past this threshold, a warning is logged.
	  Must be less than MQTT_PUBLISHER_QUEUE_DEPTH.

config MQTT_PUBLISHER_EPOCH_CACHE_TTL_MS
	int "SNTP epoch cache TTL (milliseconds)"
	default 1000
	help
	  Cache the epoch_s value for this duration to avoid repeated
	  sntp_sync_get_epoch_ms() calls in the publish loop.

config MQTT_PUBLISHER_STACK_SIZE
	int "Publisher thread stack size (bytes)"
	default 3072

config MQTT_PUBLISHER_THREAD_PRIORITY
	int "Publisher thread priority"
	default 7

config MQTT_PUBLISHER_SHELL
	bool "Shell commands for MQTT publisher configuration"
	depends on SHELL
	help
	  Adds 'mqtt_pub' shell commands:
	    mqtt_pub status
	    mqtt_pub set server <host> <port>
	    mqtt_pub set auth <user> <pass>
	    mqtt_pub set gateway <name>
	    mqtt_pub enable
	    mqtt_pub disable

module = MQTT_PUBLISHER
module-str = MQTT_PUBLISHER
source "subsys/logging/Kconfig.template.log_config"

endif # MQTT_PUBLISHER
```

## lib/pipe_publisher/Kconfig
```kconfig
# SPDX-License-Identifier: Apache-2.0
menuconfig PIPE_PUBLISHER
	bool "FIFO pipe publisher (sensor-node side, native_sim only)"
	depends on ZBUS
	depends on SENSOR_EVENT
	help
	  Subscribes to sensor_event_chan and writes each env_sensor_data
	  event as a length-prefixed protobuf SensorReading to a POSIX FIFO.
	  For native_sim integration testing only.

if PIPE_PUBLISHER

config PIPE_PUBLISHER_FIFO_PATH
	string "FIFO path"
	default "/tmp/ws-node-0"

config PIPE_PUBLISHER_THREAD_STACK_SIZE
	int "Subscriber thread stack size (bytes)"
	default 1024
	range 512 4096

config PIPE_PUBLISHER_THREAD_PRIORITY
	int "Subscriber thread priority"
	default 5
	range 0 NUM_PREEMPT_PRIORITIES

module = PIPE_PUBLISHER
module-str = PIPE_PUBLISHER
source "subsys/logging/Kconfig.template.log_config"

endif # PIPE_PUBLISHER
```

## lib/pipe_transport/Kconfig
```kconfig
# SPDX-License-Identifier: Apache-2.0
menuconfig PIPE_TRANSPORT
	bool "FIFO pipe transport (gateway side, native_sim only)"
	depends on BOARD_NATIVE_SIM
	select REMOTE_SENSOR
	select NANOPB
	help
	  Implements the remote_transport vtable reading from a POSIX FIFO.
	  Decodes SensorReading protobuf frames and publishes to sensor_event_chan.
	  For native_sim integration testing only.

if PIPE_TRANSPORT

config PIPE_TRANSPORT_FIFO_PATH
	string "FIFO path"
	default "/tmp/ws-node-0"

config PIPE_TRANSPORT_THREAD_STACK_SIZE
	int "Reader thread stack size (bytes)"
	default 1024
	range 512 4096

config PIPE_TRANSPORT_THREAD_PRIORITY
	int "Reader thread priority"
	default 6
	range 0 NUM_PREEMPT_PRIORITIES

module = PIPE_TRANSPORT
module-str = PIPE_TRANSPORT
source "subsys/logging/Kconfig.template.log_config"

endif # PIPE_TRANSPORT
```
