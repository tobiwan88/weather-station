## lib/remote_sensor/Kconfig
```kconfig
# SPDX-License-Identifier: Apache-2.0

menuconfig REMOTE_SENSOR
	bool "Remote sensor transport abstraction"
	depends on ZBUS
	depends on SENSOR_EVENT
	depends on SENSOR_TRIGGER
	depends on SENSOR_REGISTRY
	select SENSOR_REGISTRY_USER_META
	help
	  Transport-agnostic abstraction layer for sensors connected via wireless
	  protocols (BLE, LoRa, Thread, etc.).

	  Defines a transport vtable (struct remote_transport) that protocol
	  adapters implement, two zbus channels for discovery and scan control,
	  and a subscriber thread that handles registration, persistence, and
	  trigger routing. All existing consumers (dashboard, display, logger)
	  receive remote sensor data on the unchanged sensor_event_chan.

	  Protocol adapters (CONFIG_BLE_SENSOR, CONFIG_LORA_SENSOR, etc.) each
	  select this option automatically.

if REMOTE_SENSOR

config REMOTE_SENSOR_MAX_PEERS
	int "Maximum number of remote sensor peers"
	default 8
	range 1 32
	help
	  Pre-allocates this many sensor_registry_entry slots for remote sensors.
	  Remote sensors discovered at runtime consume entries from this pool.

config REMOTE_SENSOR_AUTO_REGISTER
	bool "Auto-register discovered sensors without user confirmation"
	default y
	help
	  When y, any sensor announced on remote_discovery_chan is immediately
	  registered in sensor_registry and persisted.
	  When n, discovered sensors are logged but require a shell
	  "remote_sensor pair" command to confirm registration.

config REMOTE_SENSOR_AUTO_SCAN
	bool "Start scanning all capable transports at boot"
	default y
	depends on REMOTE_SENSOR_AUTO_REGISTER
	help
	  Automatically publishes REMOTE_SCAN_START on remote_scan_ctrl_chan
	  during SYS_INIT. Individual transports start scanning immediately.
	  When n, scanning is controlled exclusively via shell or external command.

config REMOTE_SENSOR_PERSIST
	bool "Persist known remote peers across reboots"
	default y
	depends on SETTINGS
	help
	  Saves peer address, transport protocol, and assigned UID to settings
	  on each new registration. On reboot, re-registers known peers in
	  sensor_registry and calls peer_add() on the matching transport before
	  scanning begins. Settings key prefix: "rsen/".

config REMOTE_SENSOR_THREAD_STACK_SIZE
	int "Manager thread stack size (bytes)"
	default 1024
	range 512 8192

config REMOTE_SENSOR_THREAD_PRIORITY
	int "Manager thread cooperative priority"
	default 5
	range 0 NUM_PREEMPT_PRIORITIES

config REMOTE_SENSOR_SHELL
	bool "Shell commands for remote sensor management"
	default y
	depends on SHELL
	help
	  Adds the "remote_sensor" shell command group:
	    remote_sensor list               — list all registered remote sensors
	    remote_sensor scan start [proto] — start scanning (proto=ble/lora/etc.)
	    remote_sensor scan stop  [proto] — stop scanning
	    remote_sensor pair <uid_hex>     — confirm pending sensor (AUTO_REGISTER=n)
	    remote_sensor unpair <uid_hex>   — remove and forget a peer

module = REMOTE_SENSOR
module-str = REMOTE_SENSOR
source "subsys/logging/Kconfig.template.log_config"

endif # REMOTE_SENSOR
```

## lib/sensor_event/Kconfig
```kconfig
# SPDX-License-Identifier: Apache-2.0

menuconfig SENSOR_EVENT
	bool "Sensor event channel (zbus)"
	depends on ZBUS
	help
	  Enables the sensor_event_chan zbus channel and the env_sensor_data
	  struct definition used by all weather-station sensor drivers.
```

## lib/sensor_event_log/Kconfig
```kconfig
# SPDX-License-Identifier: Apache-2.0

menuconfig SENSOR_EVENT_LOG
	bool "Sensor event console logger"
	depends on ZBUS
	depends on SENSOR_EVENT
	help
	  Subscribes a zbus listener to sensor_event_chan and logs every
	  env_sensor_data event to the console in a human-readable format:

	    [00:01:23.456]  0x1234  TEMP   23.45 °C
	    [00:01:23.456]  0x1234  HUM    65.2 %RH

	  No public API — enable with CONFIG_SENSOR_EVENT_LOG=y and the
	  library registers itself via SYS_INIT.
```

## lib/sensor_registry/Kconfig
```kconfig
# SPDX-License-Identifier: Apache-2.0

menuconfig SENSOR_REGISTRY
	bool "Sensor registry (uid → metadata)"
	depends on ZBUS
	help
	  Maintains a runtime map from sensor_uid to human-readable metadata
	  (location label, remote flag). Display and MQTT consumers use the
	  registry rather than hardcoding UIDs. Sensor drivers register
	  themselves during SYS_INIT at APPLICATION priority.

if SENSOR_REGISTRY

config SENSOR_REGISTRY_USER_META
	bool "User-settable sensor metadata"
	help
	  Adds a per-sensor runtime metadata block containing a user-editable
	  display name, location override, description, and enabled flag.
	  Values are pre-seeded from Devicetree defaults on registration and
	  can be overwritten at runtime (e.g. via the HTTP dashboard).
	  Memory cost: SENSOR_REGISTRY_MAX_ENTRIES * sizeof(sensor_registry_meta).

if SENSOR_REGISTRY_USER_META

config SENSOR_REGISTRY_META_NAME_LEN
	int "Maximum display-name length (bytes, excluding NUL)"
	default 32
	range 8 64

config SENSOR_REGISTRY_META_LOCATION_LEN
	int "Maximum location string length (bytes, excluding NUL)"
	default 32
	range 8 64

config SENSOR_REGISTRY_META_DESC_LEN
	int "Maximum description string length (bytes, excluding NUL)"
	default 64
	range 8 128

config SENSOR_REGISTRY_SETTINGS
	bool "Persist sensor metadata via Zephyr settings subsystem"
	depends on SETTINGS
	help
	  When enabled, sensor_registry_set_meta() saves each changed field
	  via settings_save_one() and a SYS_INIT at APPLICATION 95 restores
	  saved values after all sensor drivers have registered (at 90/91).
	  Settings keys: sreg/<uid_hex>/name, .../loc, .../desc, .../en.
	  For native_sim use CONFIG_SETTINGS_RUNTIME; for real hardware use
	  CONFIG_SETTINGS_NVS or CONFIG_SETTINGS_FCB.

endif # SENSOR_REGISTRY_USER_META

endif # SENSOR_REGISTRY
```

## lib/sensor_trigger/Kconfig
```kconfig
# SPDX-License-Identifier: Apache-2.0

menuconfig SENSOR_TRIGGER
	bool "Sensor trigger channel (zbus)"
	depends on ZBUS
	help
	  Enables the sensor_trigger_chan zbus channel. Any publisher
	  (timer, button, MQTT) can fire a sensor_trigger_event; each fake
	  sensor driver independently listens and publishes to
	  sensor_event_chan when triggered.
```

## lib/sntp_sync/Kconfig
```kconfig
# SPDX-License-Identifier: Apache-2.0

menuconfig SNTP_SYNC
	bool "SNTP wall-clock synchronisation"
	depends on NETWORKING
	depends on SNTP
	help
	  Synchronises SYS_CLOCK_REALTIME via sntp_simple() at boot and periodically
	  thereafter. On native_sim use CONFIG_NET_NATIVE_OFFLOADED_SOCKETS so no
	  TAP device is required.

if SNTP_SYNC

config SNTP_SYNC_SERVER
	string "NTP server hostname or IP"
	default "pool.ntp.org"
	help
	  Hostname or IP address of the NTP server to query.

config SNTP_SYNC_TIMEOUT_MS
	int "SNTP query timeout in milliseconds"
	default 5000
	help
	  Maximum time to wait for a response from the NTP server.

config SNTP_SYNC_RESYNC_INTERVAL_S
	int "Periodic resync interval in seconds"
	default 3600
	help
	  How often to re-query the NTP server after the initial sync.
	  Set to 0 to disable periodic resync.

config SNTP_SYNC_THREAD_STACK_SIZE
	int "SNTP sync thread stack size in bytes"
	default 2048
	help
	  Stack size for the dedicated SNTP synchronisation thread. SNTP
	  queries run on this thread rather than the system work queue so that
	  a slow or unreachable server never stalls other work items.

config SNTP_SYNC_THREAD_PRIORITY
	int "SNTP sync thread priority"
	default 10
	help
	  Cooperative or preemptive priority of the SNTP sync thread.
	  In Zephyr, numerically lower values run at higher scheduling priority.
	  Use a numerically higher value than time-critical threads (e.g. sensor
	  triggers) so this thread runs at a lower scheduling priority.

config SNTP_SYNC_PRESYNC_DELAY_MS
	int "Pre-sync settling delay in milliseconds"
	default 0
	help
	  Milliseconds to sleep after waking from the trigger semaphore before
	  opening the SNTP UDP socket.  On platforms with offloaded sockets (e.g.
	  native_sim NSOS) a brief delay lets any in-flight socket operations on
	  other threads drain their epoll state before this thread adds a new fd.
	  Set to 0 to disable (suitable for real hardware where the issue does not
	  apply).

module = SNTP_SYNC
module-str = SNTP_SYNC
source "subsys/logging/Kconfig.template.log_config"

endif # SNTP_SYNC
```

## tests/fake_sensors/testcase.yaml
```yaml
tests:
  weather_station.fake_sensors:
    platform_allow:
      - native_sim/native/64
    harness: ztest
    tags:
      - fake_sensors
      - weather_station
```

## tests/location_registry/testcase.yaml
```yaml
tests:
  weather_station.location_registry:
    platform_allow:
      - native_sim/native/64
    harness: ztest
    tags:
      - location_registry
      - weather_station
```

## tests/mqtt_publisher/testcase.yaml
```yaml
tests:
  weather_station.mqtt_publisher:
    platform_allow:
      - native_sim/native/64
    harness: ztest
    tags:
      - mqtt_publisher
      - weather_station
```

## tests/remote_sensor_uid/testcase.yaml
```yaml
tests:
  weather_station.remote_sensor_uid:
    platform_allow:
      - native_sim/native/64
    harness: ztest
    tags:
      - remote_sensor
      - weather_station
```

## tests/sensor_event/testcase.yaml
```yaml
tests:
  weather_station.sensor_event:
    platform_allow:
      - native_sim/native/64
    harness: ztest
    tags:
      - sensor_event
      - weather_station
```
