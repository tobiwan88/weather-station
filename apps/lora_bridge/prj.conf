## CMakeLists.txt
```
cmake_minimum_required(VERSION 3.20.0)
find_package(Zephyr REQUIRED HINTS $ENV{ZEPHYR_BASE})
project(lora_bridge VERSION 0.1.0)
target_sources(app PRIVATE src/main.c)
```

## prj.conf
```kconfig
# Zephyr core
CONFIG_ZBUS=y
CONFIG_ZBUS_RUNTIME_OBSERVERS=y
CONFIG_ZBUS_RUNTIME_OBSERVERS_NODE_ALLOC_STATIC=y
CONFIG_SHELL=y
CONFIG_SHELL_BACKEND_SERIAL=y
CONFIG_FLASH=y
CONFIG_FLASH_MAP=y
CONFIG_NVS=y
CONFIG_SETTINGS=y
CONFIG_SETTINGS_NVS=y
CONFIG_CRC=y

# GPIO (LoRa RF switch, LED, button) is no longer default-on for STM32 since Zephyr 4.5
CONFIG_GPIO=y

# Hardware RNG (lora_pending jitter uses sys_rand32_get)
CONFIG_ENTROPY_GENERATOR=y
CONFIG_ENTROPY_STM32_RNG=y

# Sensor event system
CONFIG_SENSOR_EVENT=y
CONFIG_SENSOR_EVENT_LOG=y
CONFIG_SENSOR_TRIGGER=y

# Sensor registry (required by remote_sensor → lora_radio)
CONFIG_SENSOR_REGISTRY=y

# Remote sensor transport (required by lora_radio)
CONFIG_REMOTE_SENSOR=y

# LoRa radio — real SX126x driver (hardware build)
CONFIG_LORA_RADIO=y
CONFIG_LORA_RADIO_FAKE=n
CONFIG_LORA_RADIO_SHELL=y
CONFIG_LORA_RADIO_DEFAULT_SF=10
CONFIG_LORA_RADIO_DEFAULT_BW=125

# UART bridge to gateway
CONFIG_UART_LORA_SENDER=y
CONFIG_UART_LORA_SENDER_DEV_NAME="usart1"

# Shell commands
CONFIG_FAKE_SENSORS=n

# Disabled features (no display, no HTTP, no MQTT on co-processor)
CONFIG_LVGL_DISPLAY=n
CONFIG_HTTP_DASHBOARD=n
CONFIG_MQTT_PUBLISHER=n
CONFIG_CLOCK_DISPLAY=n
CONFIG_LOCATION_REGISTRY=n
```

## boards/wio_e5_mini_renode.conf
```kconfig
CONFIG_LORA_RADIO_FAKE=y
```

## boards/wio_e5_mini.overlay
```dts
/* SPDX-License-Identifier: Apache-2.0 */

/*
 * LoRa bridge overlay for lora_e5_mini.
 * Overrides USART1 baud rate to 9600 for reliable gateway co-processor link.
 * The upstream board already enables SubGHz SPI, RF switch (PA4/PA5), and LED (PB5).
 */

&usart1 {
	current-speed = <9600>;
};
```

## src/main.c
```c
#include <zephyr/kernel.h>
#include <zephyr/logging/log.h>

LOG_MODULE_REGISTER(lora_bridge, LOG_LEVEL_INF);

int main(void)
{
	LOG_INF("weather-station lora_bridge v0.1.0");
	k_sleep(K_FOREVER);
	return 0;
}
```
