## lib/io_stream/Kconfig
```kconfig
# SPDX-License-Identifier: Apache-2.0

menuconfig IO_STREAM
	bool "I/O Stream abstraction"
	help
	  Generic stream vtable for reading/writing data from pluggable
	  backends (flash, RAM buffer, file, network). Provides Unix-style
	  sequential I/O with seek, tell, size, flush, and close operations.

if IO_STREAM

config IO_STREAM_FLASH
	bool "Flash stream backend"
	depends on FLASH_MAP && IMG_MANAGER
	help
	  Stream backed by an MCUboot flash partition. Uses flash_img
	  for buffered writes with progressive erase.

config IO_STREAM_FLASH_MAX
	int "Max concurrent flash streams"
	default 2
	depends on IO_STREAM_FLASH
	range 1 4
	help
	  Maximum number of flash stream instances that can be active
	  simultaneously. Each instance consumes a static pool slot.

config IO_STREAM_FLASH_PARTITION_LABEL
	string "Flash partition label for stream"
	default "image-1"
	depends on IO_STREAM_FLASH
	help
	  Default DTS partition label used when creating a flash stream
	  without an explicit partition ID.

config IO_STREAM_BUFFER
	bool "Buffer stream backend"
	help
	  Stream backed by a caller-provided RAM buffer. For testing
	  and small data transfers. No hardware dependencies.

config IO_STREAM_BUFFER_MAX
	int "Max concurrent buffer streams"
	default 2
	depends on IO_STREAM_BUFFER
	range 1 8
	help
	  Maximum number of buffer stream instances that can be active
	  simultaneously. Each instance consumes a static pool slot.

module = IO_STREAM
module-str = IO_STREAM
source "subsys/logging/Kconfig.template.log_config"

endif # IO_STREAM
```

## lib/lora_node/Kconfig
```kconfig
# SPDX-License-Identifier: Apache-2.0

menuconfig LORA_NODE
	bool "LoRa sensor node TX library"
	depends on LORA
	select LORA_PROTO
	help
	  Lightweight LoRa transmit library for sensor nodes. Handles radio
	  initialization, session key management, packet encoding (AES-128-GCM
	  + CRC-16), and transmission.

	  Used by the outdoor_sensor_node app to send compact 5-byte sensor
	  readings to the gateway over LoRa P2P.

if LORA_NODE

config LORA_NODE_DEV_NAME
	string "LoRa device name"
	default "radio@0"
	help
	  Device name used with DEVICE_DT_GET_ONE() to locate the LoRa radio.

config LORA_NODE_DEFAULT_SF
	int "Default spreading factor"
	default 10
	range 7 12
	help
	  Default spreading factor for transmissions.

config LORA_NODE_DEFAULT_BW
	int "Default bandwidth (kHz)"
	default 125
	help
	  Default bandwidth in kHz.

config LORA_NODE_DEFAULT_FREQ
	int "Default frequency (Hz)"
	default 868000000
	help
	  Default RF frequency in Hz (EU868 band).

config LORA_NODE_TX_POWER
	int "TX power (dBm)"
	default 14
	range 2 22
	help
	  Transmit power in dBm.

config LORA_NODE_SESSION_KEY
	hex "Session key (16 bytes, for testing)"
	default 0x0
	help
	  Hard-coded 16-byte session key for testing. In production, the key
	  is provisioned with the lora_node shell and stored in NVS.

config LORA_NODE_SEQ_SETTINGS_KEY
	string "Settings key for the frame counter reservation"
	default "node/seq"
	help
	  Settings key under which the write-ahead frame counter limit
	  (reserved_until) is persisted. Used as AES-GCM nonce input.

config LORA_NODE_SEQ_RESERVE
	int "Frame counter block size reserved per flash write"
	default 64
	range 1 65536
	help
	  The node persists "next + this value" before using any counter in
	  the block. After a reboot the counter resumes at the persisted
	  limit, so a nonce is never reused. Up to this many counter values
	  are skipped per reboot.

config LORA_NODE_ALLOW_PLAINTEXT
	bool "Allow unencrypted transmissions without a session key"
	help
	  When disabled (default) lora_node_transmit() returns -EACCES
	  if no session key is available. Enable only for bring-up and tests.

config LORA_NODE_DEV_KEY
	string "Development session key (32 hex chars)"
	default ""
	help
	  If non-empty and no session is stored in settings, this 16-byte
	  key (32 hex characters) is used as the session together with
	  LORA_NODE_DEV_NODE_ID. For development and native_sim only.
	  NEVER use in production: the key is compiled into the image.

config LORA_NODE_DEV_NODE_ID
	int "Development node ID"
	default 1
	range 1 65535
	help
	  Node ID used together with LORA_NODE_DEV_KEY.

config LORA_NODE_SHELL
	bool "Shell commands for node provisioning"
	default y if SHELL
	depends on SHELL
	help
	  Adds "lora_node provision <node_id> <32-hex-key>" and
	  "lora_node status".

config LORA_NODE_SETTINGS_KEY
	string "Settings key for session data"
	default "node/session"
	help
	  NVS settings key under which the session (node_id, session_key)
	  is persisted.

module = LORA_NODE
module-str = LORA_NODE
source "subsys/logging/Kconfig.template.log_config"

endif # LORA_NODE
```

## lib/lora_proto/Kconfig
```kconfig
# SPDX-License-Identifier: Apache-2.0

config LORA_PROTO
	bool "LoRa wire protocol codec"
	select PSA_CRYPTO
	select CRC
	select PSA_WANT_KEY_TYPE_AES
	select PSA_WANT_ALG_GCM
	help
	  Shared LoRa frame definitions and packet codec (10-byte header,
	  AES-128-GCM with a 12-byte tag via PSA Crypto, CRC16) used by both
	  the sensor node (lora_node) and the gateway (lora_radio).

if LORA_PROTO

module = LORA_PROTO
module-str = LORA_PROTO
source "subsys/logging/Kconfig.template.log_config"

endif # LORA_PROTO
```
