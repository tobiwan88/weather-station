## boards/seeed/wio_e5_mini/Kconfig.wio_e5_mini
```kconfig
# Copyright (c) 2026 Seeed Studio
# SPDX-License-Identifier: Apache-2.0

config BOARD_WIO_E5_MINI
	select SOC_STM32WLE5XX
```

## boards/seeed/wio_e5_mini/board.yml
```yaml
board:
  name: wio_e5_mini
  full_name: Wio-E5 Mini
  vendor: seeed
  socs:
    - name: stm32wle5xx
```

## dev/traces/master/twister/native_sim_native_64/host_gnu/weather-station/tests/mqtt_publisher/weather_station.mqtt_publisher/Kconfig/Kconfig.modules
```kconfig
menu "weather-station (/__w/weather-station/weather-station)"
osource "/__w/weather-station/weather-station/Kconfig"
config ZEPHYR_WEATHER_STATION_MODULE
	bool
	default y
endmenu
menu "cmsis_6 (/__w/weather-station/modules/hal/cmsis_6)"
osource "$(ZEPHYR_CMSIS_6_KCONFIG)"
config ZEPHYR_CMSIS_6_MODULE
	bool
	default y
endmenu
menu "hal_nordic (/__w/weather-station/modules/hal/nordic)"
osource "$(ZEPHYR_HAL_NORDIC_KCONFIG)"
config ZEPHYR_HAL_NORDIC_MODULE
	bool
	default y

config ZEPHYR_HAL_NORDIC_MODULE_BLOBS
	bool
endmenu
menu "hal_nxp (/__w/weather-station/modules/hal/nxp)"
osource "$(ZEPHYR_HAL_NXP_KCONFIG)"
config ZEPHYR_HAL_NXP_MODULE
	bool
	default y

config ZEPHYR_HAL_NXP_MODULE_BLOBS
	bool
endmenu
menu "hal_st (/__w/weather-station/modules/hal/st)"
osource "$(ZEPHYR_HAL_ST_KCONFIG)"
config ZEPHYR_HAL_ST_MODULE
	bool
	default y
endmenu
config ZEPHYR_HAL_STM32_MODULE
	bool
	default y

config ZEPHYR_HAL_STM32_MODULE_BLOBS
	bool
menu "loramac-node (/__w/weather-station/modules/lib/loramac-node)"
osource "$(ZEPHYR_LORAMAC_NODE_KCONFIG)"
config ZEPHYR_LORAMAC_NODE_MODULE
	bool
	default y
endmenu
menu "lvgl (/__w/weather-station/modules/lib/gui/lvgl)"
osource "/__w/weather-station/modules/lib/gui/lvgl/zephyr/Kconfig"
config ZEPHYR_LVGL_MODULE
	bool
	default y
endmenu
menu "mbedtls (/__w/weather-station/modules/crypto/mbedtls)"
osource "$(ZEPHYR_MBEDTLS_KCONFIG)"
config ZEPHYR_MBEDTLS_MODULE
	bool
	default y
endmenu
config ZEPHYR_MCUBOOT_MODULE
	bool
	default y
menu "nanopb (/__w/weather-station/modules/lib/nanopb)"
osource "$(ZEPHYR_NANOPB_KCONFIG)"
config ZEPHYR_NANOPB_MODULE
	bool
	default y
endmenu
menu "segger (/__w/weather-station/modules/debug/segger)"
osource "$(ZEPHYR_SEGGER_KCONFIG)"
config ZEPHYR_SEGGER_MODULE
	bool
	default y
endmenu
config ZEPHYR_TF_PSA_CRYPTO_MODULE
	bool
	default y
```

## dev/traces/master/twister/native_sim_native_64/host_gnu/weather-station/tests/mqtt_publisher/weather_station.mqtt_publisher/Kconfig/boards/Kconfig.defconfig
```kconfig
# Load Zephyr board defconfig descriptions.
osource "/__w/weather-station/zephyr/boards/native/native_sim/Kconfig.defconfig"
```

## dev/traces/master/twister/native_sim_native_64/host_gnu/weather-station/tests/remote_sensor_manager/weather_station.remote_sensor_manager/Kconfig/soc/Kconfig.sysbuild
```kconfig
# Load Sysbuild SoC Kconfig descriptions.
osource "/__w/weather-station/zephyr/soc/xlnx/zynqmp/Kconfig.sysbuild"
osource "/__w/weather-station/zephyr/soc/xlnx/zynq7000/Kconfig.sysbuild"
osource "/__w/weather-station/zephyr/soc/xlnx/versalnet/Kconfig.sysbuild"
osource "/__w/weather-station/zephyr/soc/xlnx/versal2/Kconfig.sysbuild"
osource "/__w/weather-station/zephyr/soc/xlnx/versal/Kconfig.sysbuild"
osource "/__w/weather-station/zephyr/soc/xen/Kconfig.sysbuild"
osource "/__w/weather-station/zephyr/soc/wch/ch32v/Kconfig.sysbuild"
osource "/__w/weather-station/zephyr/soc/ti/simplelink/Kconfig.sysbuild"
osource "/__w/weather-station/zephyr/soc/ti/mspm0/Kconfig.sysbuild"
osource "/__w/weather-station/zephyr/soc/ti/lm3s6965/Kconfig.sysbuild"
osource "/__w/weather-station/zephyr/soc/ti/k3/Kconfig.sysbuild"
osource "/__w/weather-station/zephyr/soc/telink/tlsr/Kconfig.sysbuild"
osource "/__w/weather-station/zephyr/soc/syna/sr100/Kconfig.sysbuild"
osource "/__w/weather-station/zephyr/soc/starfive/jh71xx/Kconfig.sysbuild"
osource "/__w/weather-station/zephyr/soc/st/stm32/Kconfig.sysbuild"
osource "/__w/weather-station/zephyr/soc/snps/qemu_arc/Kconfig.sysbuild"
osource "/__w/weather-station/zephyr/soc/snps/nsim/arc_v/Kconfig.sysbuild"
osource "/__w/weather-station/zephyr/soc/snps/nsim/arc_classic/Kconfig.sysbuild"
osource "/__w/weather-station/zephyr/soc/snps/hsdk4xd/Kconfig.sysbuild"
osource "/__w/weather-station/zephyr/soc/snps/hsdk/Kconfig.sysbuild"
osource "/__w/weather-station/zephyr/soc/snps/emsk/Kconfig.sysbuild"
osource "/__w/weather-station/zephyr/soc/snps/emsdp/Kconfig.sysbuild"
osource "/__w/weather-station/zephyr/soc/snps/arc_iot/Kconfig.sysbuild"
osource "/__w/weather-station/zephyr/soc/silabs/Kconfig.sysbuild"
osource "/__w/weather-station/zephyr/soc/sifli/sf32/Kconfig.sysbuild"
osource "/__w/weather-station/zephyr/soc/sifive/sifive_freedom/Kconfig.sysbuild"
osource "/__w/weather-station/zephyr/soc/sensry/Kconfig.sysbuild"
osource "/__w/weather-station/zephyr/soc/rockchip/Kconfig.sysbuild"
osource "/__w/weather-station/zephyr/soc/renode/riscv_virtual/Kconfig.sysbuild"
osource "/__w/weather-station/zephyr/soc/renode/cortex_r8_virtual/Kconfig.sysbuild"
osource "/__w/weather-station/zephyr/soc/renesas/smartbond/Kconfig.sysbuild"
osource "/__w/weather-station/zephyr/soc/renesas/rz/Kconfig.sysbuild"
osource "/__w/weather-station/zephyr/soc/renesas/rx/Kconfig.sysbuild"
osource "/__w/weather-station/zephyr/soc/renesas/rcar/Kconfig.sysbuild"
osource "/__w/weather-station/zephyr/soc/renesas/ra/Kconfig.sysbuild"
osource "/__w/weather-station/zephyr/soc/realtek/fingerprint/Kconfig.sysbuild"
osource "/__w/weather-station/zephyr/soc/realtek/ec/Kconfig.sysbuild"
osource "/__w/weather-station/zephyr/soc/realtek/bee/Kconfig.sysbuild"
osource "/__w/weather-station/zephyr/soc/realtek/ameba/Kconfig.sysbuild"
osource "/__w/weather-station/zephyr/soc/raspberrypi/rpi_pico/Kconfig.sysbuild"
osource "/__w/weather-station/zephyr/soc/quicklogic/eos_s3/Kconfig.sysbuild"
osource "/__w/weather-station/zephyr/soc/qemu/virt_riscv/Kconfig.sysbuild"
osource "/__w/weather-station/zephyr/soc/qemu/or1k/Kconfig.sysbuild"
osource "/__w/weather-station/zephyr/soc/qemu/malta/Kconfig.sysbuild"
osource "/__w/weather-station/zephyr/soc/openisa/rv32m1/Kconfig.sysbuild"
osource "/__w/weather-station/zephyr/soc/openhwgroup/cva6/Kconfig.sysbuild"
osource "/__w/weather-station/zephyr/soc/oct/osd32mp15x/Kconfig.sysbuild"
osource "/__w/weather-station/zephyr/soc/nxp/s32/Kconfig.sysbuild"
osource "/__w/weather-station/zephyr/soc/nxp/rw/Kconfig.sysbuild"
osource "/__w/weather-station/zephyr/soc/nxp/mcx/Kconfig.sysbuild"
osource "/__w/weather-station/zephyr/soc/nxp/lpc/Kconfig.sysbuild"
osource "/__w/weather-station/zephyr/soc/nxp/layerscape/Kconfig.sysbuild"
osource "/__w/weather-station/zephyr/soc/nxp/kinetis/Kconfig.sysbuild"
osource "/__w/weather-station/zephyr/soc/nxp/imxrt/Kconfig.sysbuild"
osource "/__w/weather-station/zephyr/soc/nxp/imx/Kconfig.sysbuild"
osource "/__w/weather-station/zephyr/soc/nuvoton/numicro/Kconfig.sysbuild"
osource "/__w/weather-station/zephyr/soc/nuvoton/numaker/Kconfig.sysbuild"
osource "/__w/weather-station/zephyr/soc/nuvoton/npcx/Kconfig.sysbuild"
osource "/__w/weather-station/zephyr/soc/nuvoton/npcm/Kconfig.sysbuild"
osource "/__w/weather-station/zephyr/soc/nordic/Kconfig.sysbuild"
osource "/__w/weather-station/zephyr/soc/neorv32/Kconfig.sysbuild"
osource "/__w/weather-station/zephyr/soc/native/inf_clock/Kconfig.sysbuild"
osource "/__w/weather-station/zephyr/soc/microchip/sam/sama7/Kconfig.sysbuild"
osource "/__w/weather-station/zephyr/soc/microchip/sam/sam_d5x_e5x/Kconfig.sysbuild"
osource "/__w/weather-station/zephyr/soc/microchip/pic64/Kconfig.sysbuild"
osource "/__w/weather-station/zephyr/soc/microchip/pic32c/pic32cz_ca/Kconfig.sysbuild"
osource "/__w/weather-station/zephyr/soc/microchip/pic32c/pic32cx_sg/Kconfig.sysbuild"
osource "/__w/weather-station/zephyr/soc/microchip/pic32c/pic32cm_pl/Kconfig.sysbuild"
osource "/__w/weather-station/zephyr/soc/microchip/pic32c/pic32cm_jh/Kconfig.sysbuild"
osource "/__w/weather-station/zephyr/soc/microchip/miv/Kconfig.sysbuild"
osource "/__w/weather-station/zephyr/soc/microchip/mec/Kconfig.sysbuild"
osource "/__w/weather-station/zephyr/soc/mediatek/mt8xxx/Kconfig.sysbuild"
osource "/__w/weather-station/zephyr/soc/lowrisc/opentitan/Kconfig.sysbuild"
osource "/__w/weather-station/zephyr/soc/litex/litex_vexriscv/Kconfig.sysbuild"
osource "/__w/weather-station/zephyr/soc/ite/ec/Kconfig.sysbuild"
osource "/__w/weather-station/zephyr/soc/intel/wildcat_lake/Kconfig.sysbuild"
osource "/__w/weather-station/zephyr/soc/intel/raptor_lake/Kconfig.sysbuild"
osource "/__w/weather-station/zephyr/soc/intel/panther_lake/Kconfig.sysbuild"
osource "/__w/weather-station/zephyr/soc/intel/lakemont/Kconfig.sysbuild"
osource "/__w/weather-station/zephyr/soc/intel/intel_socfpga_std/Kconfig.sysbuild"
osource "/__w/weather-station/zephyr/soc/intel/intel_socfpga/Kconfig.sysbuild"
osource "/__w/weather-station/zephyr/soc/intel/intel_niosv/Kconfig.sysbuild"
osource "/__w/weather-station/zephyr/soc/intel/intel_ish/Kconfig.sysbuild"
osource "/__w/weather-station/zephyr/soc/intel/intel_adsp/Kconfig.sysbuild"
osource "/__w/weather-station/zephyr/soc/intel/elkhart_lake/Kconfig.sysbuild"
osource "/__w/weather-station/zephyr/soc/intel/atom/Kconfig.sysbuild"
osource "/__w/weather-station/zephyr/soc/intel/apollo_lake/Kconfig.sysbuild"
osource "/__w/weather-station/zephyr/soc/intel/alder_lake/Kconfig.sysbuild"
osource "/__w/weather-station/zephyr/soc/infineon/psoc4/Kconfig.sysbuild"
osource "/__w/weather-station/zephyr/soc/infineon/edge/Kconfig.sysbuild"
osource "/__w/weather-station/zephyr/soc/infineon/cat3/Kconfig.sysbuild"
osource "/__w/weather-station/zephyr/soc/infineon/cat1c/Kconfig.sysbuild"
osource "/__w/weather-station/zephyr/soc/infineon/cat1b/Kconfig.sysbuild"
osource "/__w/weather-station/zephyr/soc/infineon/cat1a/Kconfig.sysbuild"
osource "/__w/weather-station/zephyr/soc/gd/gd32/Kconfig.sysbuild"
osource "/__w/weather-station/zephyr/soc/gaisler/leon3/Kconfig.sysbuild"
osource "/__w/weather-station/zephyr/soc/gaisler/gr716a/Kconfig.sysbuild"
osource "/__w/weather-station/zephyr/soc/focaltech/Kconfig.sysbuild"
osource "/__w/weather-station/zephyr/soc/espressif/Kconfig.sysbuild"
osource "/__w/weather-station/zephyr/soc/ene/kb1200/Kconfig.sysbuild"
osource "/__w/weather-station/zephyr/soc/ene/kb106x/Kconfig.sysbuild"
osource "/__w/weather-station/zephyr/soc/elan/em32f967/Kconfig.sysbuild"
osource "/__w/weather-station/zephyr/soc/egis/Kconfig.sysbuild"
osource "/__w/weather-station/zephyr/soc/efinix/sapphire/Kconfig.sysbuild"
osource "/__w/weather-station/zephyr/soc/cdns/xtensa_sample_controller/Kconfig.sysbuild"
osource "/__w/weather-station/zephyr/soc/cdns/swerv/Kconfig.sysbuild"
osource "/__w/weather-station/zephyr/soc/cdns/sample_controller32/Kconfig.sysbuild"
osource "/__w/weather-station/zephyr/soc/cdns/dc233c/Kconfig.sysbuild"
osource "/__w/weather-station/zephyr/soc/brcm/bcmvk/Kconfig.sysbuild"
osource "/__w/weather-station/zephyr/soc/brcm/bcm2712/Kconfig.sysbuild"
osource "/__w/weather-station/zephyr/soc/brcm/bcm2711/Kconfig.sysbuild"
osource "/__w/weather-station/zephyr/soc/blackberry/qnxhv_vm/Kconfig.sysbuild"
osource "/__w/weather-station/zephyr/soc/bflb/Kconfig.sysbuild"
osource "/__w/weather-station/zephyr/soc/atmel/sam0/Kconfig.sysbuild"
osource "/__w/weather-station/zephyr/soc/atmel/sam/Kconfig.sysbuild"
osource "/__w/weather-station/zephyr/soc/aspeed/Kconfig.sysbuild"
osource "/__w/weather-station/zephyr/soc/arm/Kconfig.sysbuild"
osource "/__w/weather-station/zephyr/soc/arm/beetle/Kconfig.sysbuild"
osource "/__w/weather-station/zephyr/soc/antmicro/myra/Kconfig.sysbuild"
osource "/__w/weather-station/zephyr/soc/andestech/Kconfig.sysbuild"
osource "/__w/weather-station/zephyr/soc/amd/acp_6_0/Kconfig.sysbuild"
osource "/__w/weather-station/zephyr/soc/ambiq/Kconfig.sysbuild"
osource "/__w/weather-station/zephyr/soc/allwinner/sun8i_h3/Kconfig.sysbuild"
osource "/__w/weather-station/zephyr/soc/alif/ensemble/Kconfig.sysbuild"
osource "/__w/weather-station/zephyr/soc/aesc/Kconfig.sysbuild"
osource "/__w/weather-station/zephyr/soc/adi/max32/Kconfig.sysbuild"
```

## dev/traces/master/twister/native_sim_native_64/host_gnu/weather-station/tests/sensor_event/weather_station.sensor_event/Kconfig/Kconfig.sysbuild.modules
```kconfig
config ZEPHYR_WEATHER_STATION_MODULE
   bool
   default y
config ZEPHYR_CMSIS_6_MODULE
   bool
   default y
config ZEPHYR_HAL_NORDIC_MODULE
   bool
   default y
config ZEPHYR_HAL_NXP_MODULE
   bool
   default y
config ZEPHYR_HAL_ST_MODULE
   bool
   default y
config ZEPHYR_HAL_STM32_MODULE
   bool
   default y
config ZEPHYR_LORAMAC_NODE_MODULE
   bool
   default y
config ZEPHYR_LVGL_MODULE
   bool
   default y
config ZEPHYR_MBEDTLS_MODULE
   bool
   default y
config ZEPHYR_MCUBOOT_MODULE
   bool
   default y
config ZEPHYR_NANOPB_MODULE
   bool
   default y
config ZEPHYR_SEGGER_MODULE
   bool
   default y
config ZEPHYR_TF_PSA_CRYPTO_MODULE
   bool
   default y
```

## dev/traces/master/twister/native_sim_native_64/host_gnu/weather-station/tests/sensor_event/weather_station.sensor_event/Kconfig/arch/Kconfig.tmp
```kconfig
# Load Zephyr Arch Kconfig descriptions.
osource "/__w/weather-station/zephyr/arch/rx/Kconfig"
osource "/__w/weather-station/zephyr/arch/x86/Kconfig"
osource "/__w/weather-station/zephyr/arch/xtensa/Kconfig"
osource "/__w/weather-station/zephyr/arch/sparc/Kconfig"
osource "/__w/weather-station/zephyr/arch/riscv/Kconfig"
osource "/__w/weather-station/zephyr/arch/posix/Kconfig"
osource "/__w/weather-station/zephyr/arch/openrisc/Kconfig"
osource "/__w/weather-station/zephyr/arch/mips/Kconfig"
osource "/__w/weather-station/zephyr/arch/arm64/Kconfig"
osource "/__w/weather-station/zephyr/arch/arm/Kconfig"
osource "/__w/weather-station/zephyr/arch/arc/Kconfig"
```

## dev/traces/master/twister/native_sim_native_64/host_gnu/weather-station/tests/sensor_event/weather_station.sensor_event/Kconfig/boards/Kconfig.native_sim.tmp
```kconfig
# Load board Kconfig descriptions.
osource "/__w/weather-station/zephyr/boards/native/native_sim/Kconfig.native_sim"
```

## dev/traces/master/twister/native_sim_native_64/host_gnu/weather-station/tests/sensor_event/weather_station.sensor_event/Kconfig/boards/Kconfig.sysbuild
```kconfig
# Load Sysbuild board Kconfig descriptions.
osource "/__w/weather-station/zephyr/boards/native/native_sim/Kconfig.sysbuild"
```
