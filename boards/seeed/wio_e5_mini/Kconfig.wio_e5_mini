## dev/traces/master/twister/native_sim_native_64/host_gnu/weather-station/tests/sensor_event/weather_station.sensor_event/Kconfig/soc/Kconfig.defconfig
```kconfig
# Load Zephyr SoC defconfig descriptions.
osource "/__w/weather-station/zephyr/soc/xlnx/zynqmp/Kconfig.defconfig"
osource "/__w/weather-station/zephyr/soc/xlnx/zynq7000/Kconfig.defconfig"
osource "/__w/weather-station/zephyr/soc/xlnx/versalnet/Kconfig.defconfig"
osource "/__w/weather-station/zephyr/soc/xlnx/versal2/Kconfig.defconfig"
osource "/__w/weather-station/zephyr/soc/xlnx/versal/Kconfig.defconfig"
osource "/__w/weather-station/zephyr/soc/xen/Kconfig.defconfig"
osource "/__w/weather-station/zephyr/soc/wch/ch32v/Kconfig.defconfig"
osource "/__w/weather-station/zephyr/soc/ti/simplelink/Kconfig.defconfig"
osource "/__w/weather-station/zephyr/soc/ti/mspm0/Kconfig.defconfig"
osource "/__w/weather-station/zephyr/soc/ti/lm3s6965/Kconfig.defconfig"
osource "/__w/weather-station/zephyr/soc/ti/k3/Kconfig.defconfig"
osource "/__w/weather-station/zephyr/soc/telink/tlsr/Kconfig.defconfig"
osource "/__w/weather-station/zephyr/soc/syna/sr100/Kconfig.defconfig"
osource "/__w/weather-station/zephyr/soc/starfive/jh71xx/Kconfig.defconfig"
osource "/__w/weather-station/zephyr/soc/st/stm32/Kconfig.defconfig"
osource "/__w/weather-station/zephyr/soc/snps/qemu_arc/Kconfig.defconfig"
osource "/__w/weather-station/zephyr/soc/snps/nsim/arc_v/Kconfig.defconfig"
osource "/__w/weather-station/zephyr/soc/snps/nsim/arc_classic/Kconfig.defconfig"
osource "/__w/weather-station/zephyr/soc/snps/hsdk4xd/Kconfig.defconfig"
osource "/__w/weather-station/zephyr/soc/snps/hsdk/Kconfig.defconfig"
osource "/__w/weather-station/zephyr/soc/snps/emsk/Kconfig.defconfig"
osource "/__w/weather-station/zephyr/soc/snps/emsdp/Kconfig.defconfig"
osource "/__w/weather-station/zephyr/soc/snps/arc_iot/Kconfig.defconfig"
osource "/__w/weather-station/zephyr/soc/silabs/Kconfig.defconfig"
osource "/__w/weather-station/zephyr/soc/sifli/sf32/Kconfig.defconfig"
osource "/__w/weather-station/zephyr/soc/sifive/sifive_freedom/Kconfig.defconfig"
osource "/__w/weather-station/zephyr/soc/sensry/Kconfig.defconfig"
osource "/__w/weather-station/zephyr/soc/rockchip/Kconfig.defconfig"
osource "/__w/weather-station/zephyr/soc/renode/riscv_virtual/Kconfig.defconfig"
osource "/__w/weather-station/zephyr/soc/renode/cortex_r8_virtual/Kconfig.defconfig"
osource "/__w/weather-station/zephyr/soc/renesas/smartbond/Kconfig.defconfig"
osource "/__w/weather-station/zephyr/soc/renesas/rz/Kconfig.defconfig"
osource "/__w/weather-station/zephyr/soc/renesas/rx/Kconfig.defconfig"
osource "/__w/weather-station/zephyr/soc/renesas/rcar/Kconfig.defconfig"
osource "/__w/weather-station/zephyr/soc/renesas/ra/Kconfig.defconfig"
osource "/__w/weather-station/zephyr/soc/realtek/fingerprint/Kconfig.defconfig"
osource "/__w/weather-station/zephyr/soc/realtek/ec/Kconfig.defconfig"
osource "/__w/weather-station/zephyr/soc/realtek/bee/Kconfig.defconfig"
osource "/__w/weather-station/zephyr/soc/realtek/ameba/Kconfig.defconfig"
osource "/__w/weather-station/zephyr/soc/raspberrypi/rpi_pico/Kconfig.defconfig"
osource "/__w/weather-station/zephyr/soc/quicklogic/eos_s3/Kconfig.defconfig"
osource "/__w/weather-station/zephyr/soc/qemu/virt_riscv/Kconfig.defconfig"
osource "/__w/weather-station/zephyr/soc/qemu/or1k/Kconfig.defconfig"
osource "/__w/weather-station/zephyr/soc/qemu/malta/Kconfig.defconfig"
osource "/__w/weather-station/zephyr/soc/openisa/rv32m1/Kconfig.defconfig"
osource "/__w/weather-station/zephyr/soc/openhwgroup/cva6/Kconfig.defconfig"
osource "/__w/weather-station/zephyr/soc/oct/osd32mp15x/Kconfig.defconfig"
osource "/__w/weather-station/zephyr/soc/nxp/s32/Kconfig.defconfig"
osource "/__w/weather-station/zephyr/soc/nxp/rw/Kconfig.defconfig"
osource "/__w/weather-station/zephyr/soc/nxp/mcx/Kconfig.defconfig"
osource "/__w/weather-station/zephyr/soc/nxp/lpc/Kconfig.defconfig"
osource "/__w/weather-station/zephyr/soc/nxp/layerscape/Kconfig.defconfig"
osource "/__w/weather-station/zephyr/soc/nxp/kinetis/Kconfig.defconfig"
osource "/__w/weather-station/zephyr/soc/nxp/imxrt/Kconfig.defconfig"
osource "/__w/weather-station/zephyr/soc/nxp/imx/Kconfig.defconfig"
osource "/__w/weather-station/zephyr/soc/nuvoton/numicro/Kconfig.defconfig"
osource "/__w/weather-station/zephyr/soc/nuvoton/numaker/Kconfig.defconfig"
osource "/__w/weather-station/zephyr/soc/nuvoton/npcx/Kconfig.defconfig"
osource "/__w/weather-station/zephyr/soc/nuvoton/npcm/Kconfig.defconfig"
osource "/__w/weather-station/zephyr/soc/nordic/Kconfig.defconfig"
osource "/__w/weather-station/zephyr/soc/neorv32/Kconfig.defconfig"
osource "/__w/weather-station/zephyr/soc/native/inf_clock/Kconfig.defconfig"
osource "/__w/weather-station/zephyr/soc/microchip/sam/sama7/Kconfig.defconfig"
osource "/__w/weather-station/zephyr/soc/microchip/sam/sam_d5x_e5x/Kconfig.defconfig"
osource "/__w/weather-station/zephyr/soc/microchip/pic64/Kconfig.defconfig"
osource "/__w/weather-station/zephyr/soc/microchip/pic32c/pic32cz_ca/Kconfig.defconfig"
osource "/__w/weather-station/zephyr/soc/microchip/pic32c/pic32cx_sg/Kconfig.defconfig"
osource "/__w/weather-station/zephyr/soc/microchip/pic32c/pic32cm_pl/Kconfig.defconfig"
osource "/__w/weather-station/zephyr/soc/microchip/pic32c/pic32cm_jh/Kconfig.defconfig"
osource "/__w/weather-station/zephyr/soc/microchip/miv/Kconfig.defconfig"
osource "/__w/weather-station/zephyr/soc/microchip/mec/Kconfig.defconfig"
osource "/__w/weather-station/zephyr/soc/mediatek/mt8xxx/Kconfig.defconfig"
osource "/__w/weather-station/zephyr/soc/lowrisc/opentitan/Kconfig.defconfig"
osource "/__w/weather-station/zephyr/soc/litex/litex_vexriscv/Kconfig.defconfig"
osource "/__w/weather-station/zephyr/soc/ite/ec/Kconfig.defconfig"
osource "/__w/weather-station/zephyr/soc/intel/wildcat_lake/Kconfig.defconfig"
osource "/__w/weather-station/zephyr/soc/intel/raptor_lake/Kconfig.defconfig"
osource "/__w/weather-station/zephyr/soc/intel/panther_lake/Kconfig.defconfig"
osource "/__w/weather-station/zephyr/soc/intel/lakemont/Kconfig.defconfig"
osource "/__w/weather-station/zephyr/soc/intel/intel_socfpga_std/Kconfig.defconfig"
osource "/__w/weather-station/zephyr/soc/intel/intel_socfpga/Kconfig.defconfig"
osource "/__w/weather-station/zephyr/soc/intel/intel_niosv/Kconfig.defconfig"
osource "/__w/weather-station/zephyr/soc/intel/intel_ish/Kconfig.defconfig"
osource "/__w/weather-station/zephyr/soc/intel/intel_adsp/Kconfig.defconfig"
osource "/__w/weather-station/zephyr/soc/intel/elkhart_lake/Kconfig.defconfig"
osource "/__w/weather-station/zephyr/soc/intel/atom/Kconfig.defconfig"
osource "/__w/weather-station/zephyr/soc/intel/apollo_lake/Kconfig.defconfig"
osource "/__w/weather-station/zephyr/soc/intel/alder_lake/Kconfig.defconfig"
osource "/__w/weather-station/zephyr/soc/infineon/psoc4/Kconfig.defconfig"
osource "/__w/weather-station/zephyr/soc/infineon/edge/Kconfig.defconfig"
osource "/__w/weather-station/zephyr/soc/infineon/cat3/Kconfig.defconfig"
osource "/__w/weather-station/zephyr/soc/infineon/cat1c/Kconfig.defconfig"
osource "/__w/weather-station/zephyr/soc/infineon/cat1b/Kconfig.defconfig"
osource "/__w/weather-station/zephyr/soc/infineon/cat1a/Kconfig.defconfig"
osource "/__w/weather-station/zephyr/soc/gd/gd32/Kconfig.defconfig"
osource "/__w/weather-station/zephyr/soc/gaisler/leon3/Kconfig.defconfig"
osource "/__w/weather-station/zephyr/soc/gaisler/gr716a/Kconfig.defconfig"
osource "/__w/weather-station/zephyr/soc/focaltech/Kconfig.defconfig"
osource "/__w/weather-station/zephyr/soc/espressif/Kconfig.defconfig"
osource "/__w/weather-station/zephyr/soc/ene/kb1200/Kconfig.defconfig"
osource "/__w/weather-station/zephyr/soc/ene/kb106x/Kconfig.defconfig"
osource "/__w/weather-station/zephyr/soc/elan/em32f967/Kconfig.defconfig"
osource "/__w/weather-station/zephyr/soc/egis/Kconfig.defconfig"
osource "/__w/weather-station/zephyr/soc/efinix/sapphire/Kconfig.defconfig"
osource "/__w/weather-station/zephyr/soc/cdns/xtensa_sample_controller/Kconfig.defconfig"
osource "/__w/weather-station/zephyr/soc/cdns/swerv/Kconfig.defconfig"
osource "/__w/weather-station/zephyr/soc/cdns/sample_controller32/Kconfig.defconfig"
osource "/__w/weather-station/zephyr/soc/cdns/dc233c/Kconfig.defconfig"
osource "/__w/weather-station/zephyr/soc/brcm/bcmvk/Kconfig.defconfig"
osource "/__w/weather-station/zephyr/soc/brcm/bcm2712/Kconfig.defconfig"
osource "/__w/weather-station/zephyr/soc/brcm/bcm2711/Kconfig.defconfig"
osource "/__w/weather-station/zephyr/soc/blackberry/qnxhv_vm/Kconfig.defconfig"
osource "/__w/weather-station/zephyr/soc/bflb/Kconfig.defconfig"
osource "/__w/weather-station/zephyr/soc/atmel/sam0/Kconfig.defconfig"
osource "/__w/weather-station/zephyr/soc/atmel/sam/Kconfig.defconfig"
osource "/__w/weather-station/zephyr/soc/aspeed/Kconfig.defconfig"
osource "/__w/weather-station/zephyr/soc/arm/Kconfig.defconfig"
osource "/__w/weather-station/zephyr/soc/arm/beetle/Kconfig.defconfig"
osource "/__w/weather-station/zephyr/soc/antmicro/myra/Kconfig.defconfig"
osource "/__w/weather-station/zephyr/soc/andestech/Kconfig.defconfig"
osource "/__w/weather-station/zephyr/soc/amd/acp_6_0/Kconfig.defconfig"
osource "/__w/weather-station/zephyr/soc/ambiq/Kconfig.defconfig"
osource "/__w/weather-station/zephyr/soc/allwinner/sun8i_h3/Kconfig.defconfig"
osource "/__w/weather-station/zephyr/soc/alif/ensemble/Kconfig.defconfig"
osource "/__w/weather-station/zephyr/soc/aesc/Kconfig.defconfig"
osource "/__w/weather-station/zephyr/soc/adi/max32/Kconfig.defconfig"
```
