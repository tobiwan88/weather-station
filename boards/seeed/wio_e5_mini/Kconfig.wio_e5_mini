## dev/traces/master/twister/native_sim_native_64/host_gnu/weather-station/tests/trace_recorder/weather_station.trace_recorder_malloc/Kconfig/soc/Kconfig
```kconfig
# Load Zephyr SoC Kconfig descriptions.
osource "/__w/weather-station/zephyr/soc/xlnx/zynqmp/Kconfig"
osource "/__w/weather-station/zephyr/soc/xlnx/zynq7000/Kconfig"
osource "/__w/weather-station/zephyr/soc/xlnx/versalnet/Kconfig"
osource "/__w/weather-station/zephyr/soc/xlnx/versal2/Kconfig"
osource "/__w/weather-station/zephyr/soc/xlnx/versal/Kconfig"
osource "/__w/weather-station/zephyr/soc/xen/Kconfig"
osource "/__w/weather-station/zephyr/soc/wch/ch32v/Kconfig"
osource "/__w/weather-station/zephyr/soc/ti/simplelink/Kconfig"
osource "/__w/weather-station/zephyr/soc/ti/mspm0/Kconfig"
osource "/__w/weather-station/zephyr/soc/ti/lm3s6965/Kconfig"
osource "/__w/weather-station/zephyr/soc/ti/k3/Kconfig"
osource "/__w/weather-station/zephyr/soc/telink/tlsr/Kconfig"
osource "/__w/weather-station/zephyr/soc/syna/sr100/Kconfig"
osource "/__w/weather-station/zephyr/soc/starfive/jh71xx/Kconfig"
osource "/__w/weather-station/zephyr/soc/st/stm32/Kconfig"
osource "/__w/weather-station/zephyr/soc/snps/qemu_arc/Kconfig"
osource "/__w/weather-station/zephyr/soc/snps/nsim/arc_v/Kconfig"
osource "/__w/weather-station/zephyr/soc/snps/nsim/arc_classic/Kconfig"
osource "/__w/weather-station/zephyr/soc/snps/hsdk4xd/Kconfig"
osource "/__w/weather-station/zephyr/soc/snps/hsdk/Kconfig"
osource "/__w/weather-station/zephyr/soc/snps/emsk/Kconfig"
osource "/__w/weather-station/zephyr/soc/snps/emsdp/Kconfig"
osource "/__w/weather-station/zephyr/soc/snps/arc_iot/Kconfig"
osource "/__w/weather-station/zephyr/soc/silabs/Kconfig"
osource "/__w/weather-station/zephyr/soc/sifli/sf32/Kconfig"
osource "/__w/weather-station/zephyr/soc/sifive/sifive_freedom/Kconfig"
osource "/__w/weather-station/zephyr/soc/sensry/Kconfig"
osource "/__w/weather-station/zephyr/soc/rockchip/Kconfig"
osource "/__w/weather-station/zephyr/soc/renode/riscv_virtual/Kconfig"
osource "/__w/weather-station/zephyr/soc/renode/cortex_r8_virtual/Kconfig"
osource "/__w/weather-station/zephyr/soc/renesas/smartbond/Kconfig"
osource "/__w/weather-station/zephyr/soc/renesas/rz/Kconfig"
osource "/__w/weather-station/zephyr/soc/renesas/rx/Kconfig"
osource "/__w/weather-station/zephyr/soc/renesas/rcar/Kconfig"
osource "/__w/weather-station/zephyr/soc/renesas/ra/Kconfig"
osource "/__w/weather-station/zephyr/soc/realtek/fingerprint/Kconfig"
osource "/__w/weather-station/zephyr/soc/realtek/ec/Kconfig"
osource "/__w/weather-station/zephyr/soc/realtek/bee/Kconfig"
osource "/__w/weather-station/zephyr/soc/realtek/ameba/Kconfig"
osource "/__w/weather-station/zephyr/soc/raspberrypi/rpi_pico/Kconfig"
osource "/__w/weather-station/zephyr/soc/quicklogic/eos_s3/Kconfig"
osource "/__w/weather-station/zephyr/soc/qemu/virt_riscv/Kconfig"
osource "/__w/weather-station/zephyr/soc/qemu/or1k/Kconfig"
osource "/__w/weather-station/zephyr/soc/qemu/malta/Kconfig"
osource "/__w/weather-station/zephyr/soc/openisa/rv32m1/Kconfig"
osource "/__w/weather-station/zephyr/soc/openhwgroup/cva6/Kconfig"
osource "/__w/weather-station/zephyr/soc/oct/osd32mp15x/Kconfig"
osource "/__w/weather-station/zephyr/soc/nxp/s32/Kconfig"
osource "/__w/weather-station/zephyr/soc/nxp/rw/Kconfig"
osource "/__w/weather-station/zephyr/soc/nxp/mcx/Kconfig"
osource "/__w/weather-station/zephyr/soc/nxp/lpc/Kconfig"
osource "/__w/weather-station/zephyr/soc/nxp/layerscape/Kconfig"
osource "/__w/weather-station/zephyr/soc/nxp/kinetis/Kconfig"
osource "/__w/weather-station/zephyr/soc/nxp/imxrt/Kconfig"
osource "/__w/weather-station/zephyr/soc/nxp/imx/Kconfig"
osource "/__w/weather-station/zephyr/soc/nuvoton/numicro/Kconfig"
osource "/__w/weather-station/zephyr/soc/nuvoton/numaker/Kconfig"
osource "/__w/weather-station/zephyr/soc/nuvoton/npcx/Kconfig"
osource "/__w/weather-station/zephyr/soc/nuvoton/npcm/Kconfig"
osource "/__w/weather-station/zephyr/soc/nordic/Kconfig"
osource "/__w/weather-station/zephyr/soc/neorv32/Kconfig"
osource "/__w/weather-station/zephyr/soc/native/inf_clock/Kconfig"
osource "/__w/weather-station/zephyr/soc/microchip/sam/sama7/Kconfig"
osource "/__w/weather-station/zephyr/soc/microchip/sam/sam_d5x_e5x/Kconfig"
osource "/__w/weather-station/zephyr/soc/microchip/pic64/Kconfig"
osource "/__w/weather-station/zephyr/soc/microchip/pic32c/pic32cz_ca/Kconfig"
osource "/__w/weather-station/zephyr/soc/microchip/pic32c/pic32cx_sg/Kconfig"
osource "/__w/weather-station/zephyr/soc/microchip/pic32c/pic32cm_pl/Kconfig"
osource "/__w/weather-station/zephyr/soc/microchip/pic32c/pic32cm_jh/Kconfig"
osource "/__w/weather-station/zephyr/soc/microchip/miv/Kconfig"
osource "/__w/weather-station/zephyr/soc/microchip/mec/Kconfig"
osource "/__w/weather-station/zephyr/soc/mediatek/mt8xxx/Kconfig"
osource "/__w/weather-station/zephyr/soc/lowrisc/opentitan/Kconfig"
osource "/__w/weather-station/zephyr/soc/litex/litex_vexriscv/Kconfig"
osource "/__w/weather-station/zephyr/soc/ite/ec/Kconfig"
osource "/__w/weather-station/zephyr/soc/intel/wildcat_lake/Kconfig"
osource "/__w/weather-station/zephyr/soc/intel/raptor_lake/Kconfig"
osource "/__w/weather-station/zephyr/soc/intel/panther_lake/Kconfig"
osource "/__w/weather-station/zephyr/soc/intel/lakemont/Kconfig"
osource "/__w/weather-station/zephyr/soc/intel/intel_socfpga_std/Kconfig"
osource "/__w/weather-station/zephyr/soc/intel/intel_socfpga/Kconfig"
osource "/__w/weather-station/zephyr/soc/intel/intel_niosv/Kconfig"
osource "/__w/weather-station/zephyr/soc/intel/intel_ish/Kconfig"
osource "/__w/weather-station/zephyr/soc/intel/intel_adsp/Kconfig"
osource "/__w/weather-station/zephyr/soc/intel/elkhart_lake/Kconfig"
osource "/__w/weather-station/zephyr/soc/intel/atom/Kconfig"
osource "/__w/weather-station/zephyr/soc/intel/apollo_lake/Kconfig"
osource "/__w/weather-station/zephyr/soc/intel/alder_lake/Kconfig"
osource "/__w/weather-station/zephyr/soc/infineon/psoc4/Kconfig"
osource "/__w/weather-station/zephyr/soc/infineon/edge/Kconfig"
osource "/__w/weather-station/zephyr/soc/infineon/cat3/Kconfig"
osource "/__w/weather-station/zephyr/soc/infineon/cat1c/Kconfig"
osource "/__w/weather-station/zephyr/soc/infineon/cat1b/Kconfig"
osource "/__w/weather-station/zephyr/soc/infineon/cat1a/Kconfig"
osource "/__w/weather-station/zephyr/soc/gd/gd32/Kconfig"
osource "/__w/weather-station/zephyr/soc/gaisler/leon3/Kconfig"
osource "/__w/weather-station/zephyr/soc/gaisler/gr716a/Kconfig"
osource "/__w/weather-station/zephyr/soc/focaltech/Kconfig"
osource "/__w/weather-station/zephyr/soc/espressif/Kconfig"
osource "/__w/weather-station/zephyr/soc/ene/kb1200/Kconfig"
osource "/__w/weather-station/zephyr/soc/ene/kb106x/Kconfig"
osource "/__w/weather-station/zephyr/soc/elan/em32f967/Kconfig"
osource "/__w/weather-station/zephyr/soc/egis/Kconfig"
osource "/__w/weather-station/zephyr/soc/efinix/sapphire/Kconfig"
osource "/__w/weather-station/zephyr/soc/cdns/xtensa_sample_controller/Kconfig"
osource "/__w/weather-station/zephyr/soc/cdns/swerv/Kconfig"
osource "/__w/weather-station/zephyr/soc/cdns/sample_controller32/Kconfig"
osource "/__w/weather-station/zephyr/soc/cdns/dc233c/Kconfig"
osource "/__w/weather-station/zephyr/soc/brcm/bcmvk/Kconfig"
osource "/__w/weather-station/zephyr/soc/brcm/bcm2712/Kconfig"
osource "/__w/weather-station/zephyr/soc/brcm/bcm2711/Kconfig"
osource "/__w/weather-station/zephyr/soc/blackberry/qnxhv_vm/Kconfig"
osource "/__w/weather-station/zephyr/soc/bflb/Kconfig"
osource "/__w/weather-station/zephyr/soc/atmel/sam0/Kconfig"
osource "/__w/weather-station/zephyr/soc/atmel/sam/Kconfig"
osource "/__w/weather-station/zephyr/soc/aspeed/Kconfig"
osource "/__w/weather-station/zephyr/soc/arm/Kconfig"
osource "/__w/weather-station/zephyr/soc/arm/beetle/Kconfig"
osource "/__w/weather-station/zephyr/soc/antmicro/myra/Kconfig"
osource "/__w/weather-station/zephyr/soc/andestech/Kconfig"
osource "/__w/weather-station/zephyr/soc/amd/acp_6_0/Kconfig"
osource "/__w/weather-station/zephyr/soc/ambiq/Kconfig"
osource "/__w/weather-station/zephyr/soc/allwinner/sun8i_h3/Kconfig"
osource "/__w/weather-station/zephyr/soc/alif/ensemble/Kconfig"
osource "/__w/weather-station/zephyr/soc/aesc/Kconfig"
osource "/__w/weather-station/zephyr/soc/adi/max32/Kconfig"
```

## dts/bindings/fake,co2.yaml
```yaml
description: |
  Fake CO₂ sensor for native_sim and testing.

  Each DT node with this compatible is instantiated as an independent
  software sensor driver. The driver subscribes to sensor_trigger_chan
  and publishes env_sensor_data events on sensor_event_chan.

compatible: "fake,co2"

properties:
  initial-value-mppm:
    type: int
    required: true
    description: |
      Initial CO₂ concentration in milli-ppm (ppm × 1000).
      For example, 800000 represents 800 ppm (typical indoor ambient).
      Range: 0 .. 5000000
```

## dts/bindings/fake,humidity.yaml
```yaml
description: |
  Fake humidity sensor for native_sim and testing.

  Each DT node with this compatible is instantiated as an independent
  software sensor driver. The driver subscribes to sensor_trigger_chan
  and publishes env_sensor_data events on sensor_event_chan.

compatible: "fake,humidity"

properties:
  initial-value-mpct:
    type: int
    required: true
    description: |
      Initial relative humidity value in milli-percent (%RH × 1000).
      For example, 50000 represents 50.000 %RH.
      Range: 0 .. 100000
```

## dts/bindings/fake,temperature.yaml
```yaml
description: |
  Fake temperature sensor for native_sim and testing.

  Each DT node with this compatible is instantiated as an independent
  software sensor driver. The driver subscribes to sensor_trigger_chan
  and publishes env_sensor_data events on sensor_event_chan.

compatible: "fake,temperature"

properties:
  initial-value-mdegc:
    type: int
    required: true
    description: |
      Initial temperature value in milli-degrees Celsius (mdeg C).
      For example, 21000 represents 21.000 °C.
      Range: -40000 .. 85000
```

## dts/bindings/lora/fake,lora-radio.yaml
```yaml
description: |
  Fake LoRa radio for native_sim and testing.

  Each DT node with this compatible is instantiated as an independent
  software LoRa radio using in-process k_fifo message passing.

compatible: "fake,lora-radio"

include: base.yaml
```

## dts/bindings/sensor/dfr,sen0460.yaml
```yaml
# SPDX-License-Identifier: Apache-2.0

title: DFRobot SEN0460 PM2.5 Air Quality Sensor (I2C)

description: |
    The SEN0460 is a PM2.5 air quality sensor from DFRobot that measures
    particulate matter concentration via laser scattering.

compatible: "dfr,sen0460"

include: [sensor-device.yaml, i2c-device.yaml]

properties:
  sensor-uid:
    type: int
    description: Unique sensor identifier for the weather-station system.
```

## lib/bme680_sensor/Kconfig
```kconfig
# SPDX-License-Identifier: Apache-2.0

menuconfig BME680_SENSOR
	bool "BME680 hardware sensor"
	depends on SENSOR
	depends on SENSOR_EVENT
	depends on SENSOR_TRIGGER
	select HW_SENSOR_UTILS
	help
	  Driver for Bosch BME680/BME688 environmental sensor using
	  Zephyr's sensor API. Subscribes to sensor_trigger_chan,
	  reads temperature/humidity/pressure/gas resistance, and
	  publishes env_sensor_data events.

if BME680_SENSOR

config BME680_SENSOR_DEFAULT_UID
	hex "Default sensor UID if not specified in DT"
	default 0x0011
	help
	  Fallback UID used when the DT node does not have a sensor-uid property.

config BME680_SENSOR_ODR_MS
	int "BME680 sampling interval (ms)"
	default 1000
	range 100 60000
	help
	  Duty cycle control; higher interval = lower average current.

config BME680_SENSOR_HEATER_PROFILE
	string "BME680 heater profile (temperature/duration pairs)"
	default ""
	help
	  BME680 MOX gas sensor requires heater; profile string passed at
	  enable time. Empty = default. Future: load from settings.

config BME680_SENSOR_FORCED_MODE
	bool "Use forced mode (power down between samples)"
	default y
	help
	  When enabled, sensor powers down between samples (lowest power).
	  When disabled, runs in normal mode (higher power, faster response).

config BME680_SENSOR_LOG_LEVEL
	int "Log level"
	default 3

module = BME680_SENSOR
module-str = bme680_sensor
source "subsys/logging/Kconfig.template.log_config"

endif # BME680_SENSOR
```

## lib/fota_confirm/Kconfig
```kconfig
# SPDX-License-Identifier: Apache-2.0

menuconfig FOTA_CONFIRM
	bool "Auto-confirm firmware image after successful boot"
	depends on BOOTLOADER_MCUBOOT && IMG_MANAGER
	help
	  Schedules boot_write_img_confirmed() after a configurable settle
	  delay at SYS_INIT APPLICATION priority 99 (after all other libs
	  have initialised). Without confirmation, MCUboot treats the running
	  image as a test image and reverts to the previous slot on the next
	  reset.

if FOTA_CONFIRM

config FOTA_CONFIRM_DELAY_S
	int "Settle delay before confirming image (seconds)"
	default 5
	range 1 60
	help
	  How long to wait after SYS_INIT APPLICATION 99 before calling
	  boot_write_img_confirmed(). Allows HTTP dashboard, MQTT, and SNTP
	  to bind their sockets before the image is marked permanent.
	  Note: boot_write_img_confirmed() calls flash_area_write() on the
	  system work queue; keep the delay long enough that other work queue
	  consumers (MQTT reconnect, SNTP) have completed their init writes.

config FOTA_CONFIRM_REQUIRE_SENSOR_EVENT
	bool "Confirm only after a sensor event has been published"
	depends on SENSOR_EVENT
	select ZBUS_CHANNEL_PUBLISH_STATS
	help
	  Before confirming, require at least one event on sensor_event_chan.
	  A new image that boots but never produces sensor data is then not
	  confirmed, so MCUboot reverts it on the next reset. Only enable this
	  when a sensor reports well within
	  FOTA_CONFIRM_DELAY_S * (FOTA_CONFIRM_MAX_RETRIES + 1) seconds.

config FOTA_CONFIRM_MAX_RETRIES
	int "Health-check retries before giving up on confirmation"
	default 6
	range 0 60
	help
	  Number of times the confirm work is rescheduled (every
	  FOTA_CONFIRM_DELAY_S seconds) while the health check fails. After
	  the last retry the image is left unconfirmed and MCUboot reverts it
	  on the next reset.

module = FOTA_CONFIRM
module-str = FOTA_CONFIRM
source "subsys/logging/Kconfig.template.log_config"

endif # FOTA_CONFIRM
```

## lib/fota_relay/Kconfig
```kconfig
# SPDX-License-Identifier: Apache-2.0

config FOTA_RELAY
	bool "FOTA relay transport interface (stub)"
	help
	  Exposes the fota_relay_transport_api vtable header for transports
	  that relay firmware updates from the gateway to sensor nodes.
	  No implementation is provided; this is a placeholder for future
	  wireless relay support (LoRa, BLE). See ADR-014.
```

## lib/hw_sensor_utils/Kconfig
```kconfig
# SPDX-License-Identifier: Apache-2.0

config HW_SENSOR_UTILS
	bool "Hardware sensor utilities"
	depends on SENSOR_EVENT
	help
	  Shared utility functions for hardware sensor drivers.
	  Provides hw_sensor_publish() for building and publishing
	  env_sensor_data events.
```
