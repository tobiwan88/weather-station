/* SPDX-License-Identifier: Apache-2.0 */

#include <zephyr/kernel.h>
#include <zephyr/device.h>
#include <zephyr/devicetree.h>
#include <zephyr/logging/log.h>
#include <zephyr/zbus/zbus.h>
#include <zephyr/sys/iterable_sections.h>
#include <zephyr/init.h>

#include <sensor_event/sensor_event.h>
#include <sensor_trigger/sensor_trigger.h>
#include <sensor_registry/sensor_registry.h>
#include <fake_sensors/fake_sensors.h>

LOG_MODULE_REGISTER(fake_humidity, LOG_LEVEL_INF);

/* Compatible string that DT nodes must carry. */
#define DT_COMPAT fake_humidity

/*
 * Per-instance data and functions generated by DT_FOREACH_STATUS_OKAY.
 * Each DT node with compatible="fake,humidity" and status="okay" expands
 * into its own static data block and contributes to the shared zbus listener.
 */

/* --------------------------------------------------------------------------
 * Helper macro — publish one humidity reading for the given entry.
 * Value stored as milli-%RH; divide by 1000 for actual %RH.
 * -------------------------------------------------------------------------- */
#define FAKE_HUM_PUBLISH(entry_ptr)                                                                \
	do {                                                                                       \
		struct env_sensor_data evt = {                                                     \
			.sensor_uid   = (entry_ptr)->uid,                                          \
			.type         = SENSOR_TYPE_HUMIDITY,                                      \
			.q31_value    = humidity_pct_to_q31(*(entry_ptr)->value_milli / 1000.0),   \
			.timestamp_ms = k_uptime_get(),                                            \
		};                                                                                 \
		int rc = zbus_chan_pub(&sensor_event_chan, &evt, K_NO_WAIT);                       \
		if (rc != 0) {                                                                     \
			LOG_WRN("uid 0x%04x: pub failed (%d)", (entry_ptr)->uid, rc);              \
		}                                                                                  \
	} while (0)

/* Forward-declare publish function per instance. */
#define FAKE_HUM_PUBLISH_FN_DECL(node_id)                                                          \
	static void fake_hum_publish_##node_id(struct fake_sensor_entry *entry);

DT_FOREACH_STATUS_OKAY(DT_COMPAT, FAKE_HUM_PUBLISH_FN_DECL)

/* Per-instance milli-%RH storage. */
#define FAKE_HUM_DATA_DECL(node_id)                                                                \
	static int32_t fake_hum_mpct_##node_id =                                                   \
		DT_PROP(node_id, initial_value_mpct);

DT_FOREACH_STATUS_OKAY(DT_COMPAT, FAKE_HUM_DATA_DECL)

/* Per-instance fake_sensor_entry in iterable section. */
#define FAKE_HUM_ENTRY_DECL(node_id)                                                               \
	STRUCT_SECTION_ITERABLE(fake_sensor_entry, fake_hum_entry_##node_id) = {                   \
		.uid         = DT_PROP(node_id, sensor_uid),                                       \
		.kind        = FAKE_SENSOR_KIND_HUMIDITY,                                          \
		.label       = DT_NODE_FULL_NAME(node_id),                                         \
		.location    = DT_PROP(node_id, location),                                         \
		.value_milli = &fake_hum_mpct_##node_id,                                           \
		.publish     = fake_hum_publish_##node_id,                                         \
	};

DT_FOREACH_STATUS_OKAY(DT_COMPAT, FAKE_HUM_ENTRY_DECL)

/* Per-instance publish function implementation. */
#define FAKE_HUM_PUBLISH_FN_IMPL(node_id)                                                          \
	static void fake_hum_publish_##node_id(struct fake_sensor_entry *entry)                \
	{                                                                                          \
		FAKE_HUM_PUBLISH(entry);                                                           \
		LOG_DBG("uid 0x%04x: %.1f %%RH",                                                  \
			entry->uid, (double)(*entry->value_milli) / 1000.0);                      \
	}

DT_FOREACH_STATUS_OKAY(DT_COMPAT, FAKE_HUM_PUBLISH_FN_IMPL)

/* --------------------------------------------------------------------------
 * zbus listener callback — shared by all humidity instances.
 * -------------------------------------------------------------------------- */
static void fake_hum_trigger_cb(const struct zbus_channel *chan)
{
	const struct sensor_trigger_event *trig = zbus_chan_const_msg(chan);

	STRUCT_SECTION_FOREACH(fake_sensor_entry, entry) {
		if (entry->kind != FAKE_SENSOR_KIND_HUMIDITY) {
			continue;
		}
		if (trig->target_uid != 0 && trig->target_uid != entry->uid) {
			continue;
		}
		FAKE_HUM_PUBLISH(entry);
	}
}

ZBUS_LISTENER_DEFINE(fake_hum_listener, fake_hum_trigger_cb);

/* --------------------------------------------------------------------------
 * SYS_INIT: register sensor_trigger_chan observer + sensor_registry entries
 * -------------------------------------------------------------------------- */

#define FAKE_HUM_REGISTRY_ENTRY_DECL(node_id)                                                      \
	static const struct sensor_registry_entry fake_hum_reg_##node_id = {                       \
		.uid       = DT_PROP(node_id, sensor_uid),                                         \
		.label     = DT_NODE_FULL_NAME(node_id),                                           \
		.location  = DT_PROP(node_id, location),                                           \
		.is_remote = false,                                                                \
	};

DT_FOREACH_STATUS_OKAY(DT_COMPAT, FAKE_HUM_REGISTRY_ENTRY_DECL)

#define FAKE_HUM_REGISTRY_REGISTER(node_id)                                                        \
	do {                                                                                       \
		int _rc = sensor_registry_register(&fake_hum_reg_##node_id);                       \
		if (_rc != 0 && _rc != -EEXIST) {                                                  \
			LOG_ERR("registry register uid 0x%04x failed: %d",                        \
				DT_PROP(node_id, sensor_uid), _rc);                                \
		}                                                                                  \
	} while (0)

static int fake_hum_init(void)
{
	int rc = zbus_chan_add_obs(&sensor_trigger_chan, &fake_hum_listener, K_NO_WAIT);

	if (rc != 0) {
		LOG_ERR("Failed to add trigger observer: %d", rc);
		return rc;
	}

	DT_FOREACH_STATUS_OKAY(DT_COMPAT, FAKE_HUM_REGISTRY_REGISTER)

	LOG_INF("fake_humidity: init done");
	return 0;
}

SYS_INIT(fake_hum_init, APPLICATION, 91);
