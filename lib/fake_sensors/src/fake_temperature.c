/* SPDX-License-Identifier: Apache-2.0 */

#include <zephyr/device.h>
#include <zephyr/devicetree.h>
#include <zephyr/init.h>
#include <zephyr/kernel.h>
#include <zephyr/logging/log.h>
#include <zephyr/sys/iterable_sections.h>
#include <zephyr/sys/util.h>
#include <zephyr/zbus/zbus.h>

#include <fake_sensors/fake_sensors.h>
#include <sensor_event/sensor_event.h>
#include <sensor_registry/sensor_registry.h>
#include <sensor_trigger/sensor_trigger.h>

#ifdef CONFIG_FAKE_SENSORS_JITTER
#	include <zephyr/random/random.h>
/* Apply ±max_milli random offset; stored value is unchanged. */
#	define FAKE_SENSOR_JITTER(val, max_milli)                                                 \
		((val) + (int32_t)(sys_rand32_get() % (uint32_t)((max_milli) * 2 + 1)) -           \
		 (max_milli))
#else
#	define FAKE_SENSOR_JITTER(val, max_milli) (val)
#endif

/* Jitter range for temperature: ±0.5 °C */
#define FAKE_TEMP_JITTER_MILLI 500

LOG_MODULE_REGISTER(fake_temperature, CONFIG_FAKE_SENSORS_LOG_LEVEL);

#define DT_COMPAT     fake_temperature
#define DT_DRV_COMPAT DT_COMPAT

/*
 * Per-instance data and functions generated by LISTIFY + DT_INST.
 * Each DT node with compatible="fake,temperature" and status="okay"
 * expands into its own static data block and zbus listener.
 *
 * UIDs are assigned at build time: CONFIG_FAKE_TEMPERATURE_UID_BASE + instance_index.
 */

#define FAKE_TEMP_PUBLISH(entry_ptr)                                                               \
	do {                                                                                       \
		int32_t _mval =                                                                    \
			FAKE_SENSOR_JITTER(*(entry_ptr)->value_milli, FAKE_TEMP_JITTER_MILLI);     \
		/* Clamp to valid temperature range [-40, +85°C in milli-°C] */                  \
		_mval = CLAMP(_mval, -40000, 85000);                                               \
		struct env_sensor_data evt = {                                                     \
			.sensor_uid = (entry_ptr)->uid,                                            \
			.type = SENSOR_TYPE_TEMPERATURE,                                           \
			.q31_value = temperature_c_to_q31(_mval / 1000.0),                         \
			.timestamp_ms = k_uptime_get(),                                            \
		};                                                                                 \
		int rc = zbus_chan_pub(&sensor_event_chan, &evt, K_NO_WAIT);                       \
		if (rc != 0) {                                                                     \
			LOG_WRN("uid 0x%04x: pub failed (%d)", (entry_ptr)->uid, rc);              \
		}                                                                                  \
	} while (0)

#define NUM_TEMP_INST DT_NUM_INST_STATUS_OKAY(DT_COMPAT)

/* Forward-declare publish function per instance. */
#define FAKE_TEMP_PUBLISH_FN_DECL(i, _)                                                            \
	static void fake_temp_publish_##i(struct fake_sensor_entry *entry);

LISTIFY(NUM_TEMP_INST, FAKE_TEMP_PUBLISH_FN_DECL, ())

/* Per-instance milli-°C storage. */
#define FAKE_TEMP_DATA_DECL(i, _)                                                                  \
	static int32_t fake_temp_mdegc_##i = DT_INST_PROP(i, initial_value_mdegc);

LISTIFY(NUM_TEMP_INST, FAKE_TEMP_DATA_DECL, ())

/* Per-instance fake_sensor_entry in iterable section. */
#define FAKE_TEMP_ENTRY_DECL(i, _)                                                                 \
	STRUCT_SECTION_ITERABLE(fake_sensor_entry, fake_temp_entry_##i) = {                        \
		.uid = CONFIG_FAKE_TEMPERATURE_UID_BASE + i,                                       \
		.kind = FAKE_SENSOR_KIND_TEMPERATURE,                                              \
		.label = DT_NODE_FULL_NAME(DT_INST(i, DT_COMPAT)),                                 \
		.value_milli = &fake_temp_mdegc_##i,                                               \
		.publish = fake_temp_publish_##i,                                                  \
	};

LISTIFY(NUM_TEMP_INST, FAKE_TEMP_ENTRY_DECL, ())

/* Per-instance publish function implementation. */
#define FAKE_TEMP_PUBLISH_FN_IMPL(i, _)                                                            \
	static void fake_temp_publish_##i(struct fake_sensor_entry *entry)                         \
	{                                                                                          \
		FAKE_TEMP_PUBLISH(entry);                                                          \
		LOG_DBG("uid 0x%04x: %.2f °C", entry->uid,                                         \
			(double)(*entry->value_milli) / 1000.0);                                   \
	}

LISTIFY(NUM_TEMP_INST, FAKE_TEMP_PUBLISH_FN_IMPL, ())

/* --------------------------------------------------------------------------
 * zbus listener callback — shared by all temperature instances.
 * Called from the zbus thread when sensor_trigger_chan is published.
 * -------------------------------------------------------------------------- */
static void fake_temp_trigger_cb(const struct zbus_channel *chan)
{
	const struct sensor_trigger_event *trig = zbus_chan_const_msg(chan);

	STRUCT_SECTION_FOREACH(fake_sensor_entry, entry)
	{
		if (entry->kind != FAKE_SENSOR_KIND_TEMPERATURE) {
			continue;
		}
		if (trig->target_uid != 0 && trig->target_uid != entry->uid) {
			continue;
		}
		FAKE_TEMP_PUBLISH(entry);
	}
}

ZBUS_LISTENER_DEFINE(fake_temp_listener, fake_temp_trigger_cb);

/* --------------------------------------------------------------------------
 * SYS_INIT: register sensor_trigger_chan observer + sensor_registry entries
 * -------------------------------------------------------------------------- */

#define FAKE_TEMP_REGISTRY_ENTRY_DECL(i, _)                                                        \
	static const struct sensor_registry_entry fake_temp_reg_##i = {                            \
		.uid = CONFIG_FAKE_TEMPERATURE_UID_BASE + i,                                       \
		.label = DT_NODE_FULL_NAME(DT_INST(i, DT_COMPAT)),                                 \
		.is_remote = false,                                                                \
	};

LISTIFY(NUM_TEMP_INST, FAKE_TEMP_REGISTRY_ENTRY_DECL, ())

#define FAKE_TEMP_REGISTRY_REGISTER(i, _)                                                          \
	{                                                                                          \
		int _rc = sensor_registry_register(&fake_temp_reg_##i);                            \
		if (_rc != 0 && _rc != -EEXIST) {                                                  \
			LOG_ERR("registry register uid 0x%04x failed: %d",                         \
				CONFIG_FAKE_TEMPERATURE_UID_BASE + i, _rc);                        \
		}                                                                                  \
	}

static int fake_temp_init(void)
{
	/* Attach listener to the trigger channel. */
	int rc = zbus_chan_add_obs(&sensor_trigger_chan, &fake_temp_listener, K_NO_WAIT);

	if (rc != 0) {
		LOG_ERR("Failed to add trigger observer: %d", rc);
		return rc;
	}

	/* Register each DT-instantiated sensor in the registry. */
	LISTIFY(NUM_TEMP_INST, FAKE_TEMP_REGISTRY_REGISTER, ())

	/* Fire a startup trigger so consumers see an initial value. */
	struct sensor_trigger_event startup = {
		.source = TRIGGER_SOURCE_STARTUP,
		.target_uid = 0,
	};
	zbus_chan_pub(&sensor_trigger_chan, &startup, K_MSEC(100));

	LOG_INF("fake_temperature: init done");
	return 0;
}

SYS_INIT(fake_temp_init, APPLICATION, 90);
