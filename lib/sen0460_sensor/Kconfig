## lib/sen0460_sensor/Kconfig
```kconfig
# SPDX-License-Identifier: Apache-2.0

menuconfig SEN0460_SENSOR
	bool "SEN0460 PM2.5 sensor (read/decode API)"
	depends on SENSOR
	depends on SENSOR_EVENT
	depends on SENSOR_TRIGGER
	depends on I2C
	select RTIO
	select HW_SENSOR_UTILS
	help
	  Driver for DFRobot SEN0460 PM2.5 air quality sensor (I2C).
	  Uses Zephyr's read/decode sensor API (sensor_submit_t + sensor_decoder_api).
	  Measures PM1.0, PM2.5, PM10 standard concentration.
	  Subscribes to sensor_trigger_chan and publishes env_sensor_data events.

if SEN0460_SENSOR

config SEN0460_SENSOR_DEFAULT_UID
	hex "Default sensor UID"
	default 0x0021

config SEN0460_SENSOR_SETTLE_MS
	int "Settle delay after wake (ms)"
	default 10000
	range 0 30000
	help
	  Delay between waking the sensor and reading. The internal laser
	  and fan need time to stabilize for accurate PM readings.

config SEN0460_SENSOR_SAMPLE_INTERVAL_SEC
	int "Sample interval (seconds)"
	default 300
	range 10 3600
	help
	  Interval between measurement cycles. Used by the trigger source
	  (sensor_trigger) to configure the timer period. Set at compile-time;
	  runtime override via config_cmd_chan is deferred.

config SEN0460_SENSOR_LOG_LEVEL
	int "Log level"
	default 3

module = SEN0460_SENSOR
module-str = sen0460_sensor
source "subsys/logging/Kconfig.template.log_config"

endif # SEN0460_SENSOR
```

## lib/sensor_node_tx/Kconfig
```kconfig
# SPDX-License-Identifier: Apache-2.0

menuconfig SENSOR_NODE_TX
	bool "Sensor Node LoRa TX"
	depends on LORA_NODE
	select SENSOR_EVENT
	select CONFIG_CMD
	default y
	help
	  Zbus consumer that accumulates env_sensor_data events and transmits
	  them as compact 5-byte LoRa readings on a configurable interval.

if SENSOR_NODE_TX

config SENSOR_NODE_TX_INTERVAL_S
	int "TX interval in seconds"
	default 60
	range 4 3600
	help
	  How often to transmit accumulated sensor readings via LoRa.

config SENSOR_NODE_TX_MAX_READINGS
	int "Max readings per TX batch"
	default 20
	range 4 64
	help
	  Maximum number of sensor readings to buffer before transmission.
	  Limited by the LoRa payload budget at the configured spreading factor.

config SENSOR_NODE_TX_LOG_LEVEL
	int "Log level"
	default 3

module = SENSOR_NODE_TX
module-str = SENSOR_NODE_TX
source "subsys/logging/Kconfig.template.log_config"

endif # SENSOR_NODE_TX
```

## lib/uart_lora_bridge/Kconfig
```kconfig
# SPDX-License-Identifier: Apache-2.0

config UART_LORA_BRIDGE
	bool "UART LoRa bridge (co-MCU proxy)"
	depends on ZBUS
	depends on SENSOR_EVENT
	depends on SERIAL
	depends on UART_INTERRUPT_DRIVEN
	help
	  Receives env_sensor_data frames over UART from a co-MCU that manages
	  the LoRa radio and publishes them directly to sensor_event_chan.

	  Wire frame format (24 bytes per event):
	    [0x5A][0xA5]  2-byte magic sync word
	    [len]         1-byte payload length (always 20)
	    [payload]     20-byte packed env_sensor_data (LE)
	    [crc8]        1-byte CRC8-CCITT over payload

	  Use instead of CONFIG_LORA_RADIO on hardware targets where a
	  separate MCU (e.g. a LoRa node running the lora_radio firmware)
	  handles the radio link and streams decoded readings via UART.

if UART_LORA_BRIDGE

config UART_LORA_BRIDGE_DEV_NAME
	string "UART device name"
	default "lpuart2"
	help
	  Zephyr device name of the UART port connected to the LoRa co-MCU.
	  Must not conflict with the console or MCUmgr UART.

config UART_LORA_BRIDGE_RX_STACK_SIZE
	int "RX thread stack size (bytes)"
	default 1024

config UART_LORA_BRIDGE_RX_PRIORITY
	int "RX thread priority"
	default 7

module = UART_LORA_BRIDGE
module-str = UART_LORA_BRIDGE
source "subsys/logging/Kconfig.template.log_config"

endif # UART_LORA_BRIDGE
```

## lib/uart_lora_sender/Kconfig
```kconfig
# SPDX-License-Identifier: Apache-2.0

config UART_LORA_SENDER
	bool "UART LoRa sender (co-MCU TX bridge)"
	depends on ZBUS
	depends on SENSOR_EVENT
	depends on SERIAL
	help
	  Subscribes to sensor_event_chan and forwards env_sensor_data events
	  to the gateway over UART using a 24-byte wire frame format.

	  Wire frame format (24 bytes per event):
	    [0x5A][0xA5]  2-byte magic sync word
	    [len]         1-byte payload length (always 20)
	    [payload]     20-byte packed env_sensor_data (LE)
	    [crc8]        1-byte CRC8-CCITT over payload

	  Runs on the LoRa co-processor (Wio-E5 Mini) to stream decoded
	  sensor readings to the gateway MCU.

if UART_LORA_SENDER

config UART_LORA_SENDER_DEV_NAME
	string "UART device name"
	default "usart1"
	help
	  Zephyr device name of the UART port connected to the gateway MCU.

config UART_LORA_SENDER_THREAD_STACK_SIZE
	int "Sender thread stack size (bytes)"
	default 1024

config UART_LORA_SENDER_THREAD_PRIORITY
	int "Sender thread priority"
	default 7

module = UART_LORA_SENDER
module-str = UART_LORA_SENDER
source "subsys/logging/Kconfig.template.log_config"

endif # UART_LORA_SENDER
```

## tests/integration/testcase.yaml
```yaml
tests:
  weather_station.integration:
    platform_allow:
      - native_sim/native/64
    harness: pytest
    harness_config:
      pytest_dut_scope: function
      pytest_root:
        - "pytest/"
      pytest_args:
        - "--ignore-glob=*test_http_force_pw.py"
    tags:
      - integration
      - weather_station
    integration_platforms:
      - native_sim/native/64
    extra_configs:
      - CONFIG_UART_NATIVE_PTY_0_ON_STDINOUT=y
      - CONFIG_HTTP_DASHBOARD_AUTH_FORCE_PW_CHANGE=n
    timeout: 240
  weather_station.integration.force_pw:
    platform_allow:
      - native_sim/native/64
    harness: pytest
    harness_config:
      pytest_dut_scope: function
      pytest_root:
        - "pytest/test_http_force_pw.py"
    tags:
      - integration
      - weather_station
    integration_platforms:
      - native_sim/native/64
    extra_configs:
      - CONFIG_UART_NATIVE_PTY_0_ON_STDINOUT=y
      - CONFIG_HTTP_DASHBOARD_AUTH_FORCE_PW_CHANGE=y
      # Own port: twister runs both scenarios in parallel on one host.
      - CONFIG_HTTP_DASHBOARD_PORT=8081
    timeout: 120
```

## tests/io_stream/testcase.yaml
```yaml
tests:
  weather_station.io_stream:
    platform_allow:
      - native_sim/native/64
    harness: ztest
    tags:
      - io_stream
      - weather_station
  weather_station.io_stream_flash:
    platform_allow:
      - native_sim/native/64
    harness: ztest
    extra_args:
      - OVERLAY_CONFIG=prj_flash.conf
      - OVERLAY_CONFIG+=overlay_flash_sim.dts
    tags:
      - io_stream
      - io_stream_flash
      - weather_station
```

## tests/lora_packet/testcase.yaml
```yaml
tests:
  weather_station.lora_packet:
    platform_allow:
      - native_sim/native/64
    harness: ztest
    tags:
      - lora_packet
      - weather_station
```

## tests/lora_session/testcase.yaml
```yaml
tests:
  weather_station.lora_session:
    platform_allow:
      - native_sim/native/64
    harness: ztest
    tags:
      - lora_session
      - weather_station
```

## tests/sensor_node_tx/testcase.yaml
```yaml
tests:
  weather_station.sensor_node_tx:
    platform_allow:
      - native_sim/native/64
    harness: ztest
    tags:
      - sensor_node_tx
      - weather_station
```

## tests/sensor_registry/testcase.yaml
```yaml
tests:
  weather_station.sensor_registry:
    platform_allow:
      - native_sim/native/64
    harness: ztest
    tags:
      - sensor_registry
      - weather_station
  weather_station.sensor_registry.user_meta:
    platform_allow:
      - native_sim/native/64
    harness: ztest
    tags:
      - sensor_registry
      - weather_station
    extra_configs:
      - CONFIG_SENSOR_REGISTRY_USER_META=y
```

## tests/trace_recorder/testcase.yaml
```yaml
tests:
  weather_station.trace_recorder:
    platform_allow: native_sim/native/64
    harness: ztest
    tags: trace_recorder
    extra_args:
      - CONFIG_TRACING=y
      - CONFIG_TRACING_USER=y
      - CONFIG_TRACE_RECORDER=y
      - CONFIG_TRACE_RECORDER_SHELL=n
      - CONFIG_TRACE_RECORDER_MAX_THREADS=4
      - CONFIG_TRACE_RECORDER_BUFFER_SIZE=16
```

## west.yml
```yaml
manifest:
  version: "0.13"

  self:
    path: .

  remotes:
    - name: zephyrproject-rtos
      url-base: https://github.com/zephyrproject-rtos

  projects:
    - name: zephyr
      remote: zephyrproject-rtos
      revision: v4.4.0
      import:
        name-allowlist:
          - cmsis_6
          - hal_nordic
          - hal_nxp
          - hal_st
          - hal_stm32
          - mbedtls
          - tf-psa-crypto
          - lvgl
          - loramac-node
          - segger
          - nanopb
          - mcuboot
```
