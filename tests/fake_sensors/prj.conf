## CMakeLists.txt
```
# SPDX-License-Identifier: Apache-2.0

cmake_minimum_required(VERSION 3.20.0)

find_package(Zephyr REQUIRED HINTS $ENV{ZEPHYR_BASE})
project(test_fake_sensors)

target_sources(app PRIVATE src/main.c)
```

## prj.conf
```kconfig
CONFIG_ZBUS=y
CONFIG_ZBUS_CHANNEL_NAME=y
CONFIG_ZBUS_OBSERVER_NAME=y
CONFIG_ZBUS_RUNTIME_OBSERVERS=y
CONFIG_ZTEST=y
CONFIG_SENSOR_EVENT=y
CONFIG_SENSOR_TRIGGER=y
CONFIG_SENSOR_REGISTRY=y
CONFIG_FAKE_SENSORS=y
CONFIG_FAKE_TEMPERATURE_UID_BASE=0x0101
CONFIG_FAKE_HUMIDITY_UID_BASE=0x0102
```

## boards/native_sim_native_64.overlay
```dts
/*
 * SPDX-License-Identifier: Apache-2.0
 *
 * DT overlay for the fake_sensors test suite.
 * Provides one temperature and one humidity fake sensor so that
 * STRUCT_SECTION_COUNT(fake_sensor_entry) > 0 and the trigger test
 * can receive events on sensor_event_chan.
 */

/ {
	fake_temp_test: fake-temp-test {
		compatible = "fake,temperature";
		initial-value-mdegc = <22000>;
		status = "okay";
	};

	fake_hum_test: fake-hum-test {
		compatible = "fake,humidity";
		initial-value-mpct = <45000>;
		status = "okay";
	};
};
```

## src/main.c
```c
/* SPDX-License-Identifier: Apache-2.0 */
/**
 * @file main.c (test/fake_sensors)
 * @brief Integration tests for the fake_sensors module.
 *
 * Two DT nodes are defined in boards/native_sim.overlay:
 *   fake_temp_test (uid=0x0101, "fake,temperature")
 *   fake_hum_test  (uid=0x0102, "fake,humidity")
 */

#include <zephyr/kernel.h>
#include <zephyr/sys/atomic.h>
#include <zephyr/sys/iterable_sections.h>
#include <zephyr/zbus/zbus.h>
#include <zephyr/ztest.h>

#include <fake_sensors/fake_sensors.h>
#include <sensor_event/sensor_event.h>
#include <sensor_trigger/sensor_trigger.h>

/* Semaphore posted by the test's event listener when an event arrives. */
static K_SEM_DEFINE(event_received_sem, 0, 1);
static struct env_sensor_data last_event;

static void test_event_cb(const struct zbus_channel *chan)
{
	const struct env_sensor_data *evt = zbus_chan_const_msg(chan);

	last_event = *evt;
	k_sem_give(&event_received_sem);
}

ZBUS_LISTENER_DEFINE(test_event_listener, test_event_cb);

/* Counts TRIGGER_SOURCE_TIMER events published on sensor_trigger_chan. */
static atomic_t timer_trigger_count = ATOMIC_INIT(0);

static void test_trigger_cb(const struct zbus_channel *chan)
{
	const struct sensor_trigger_event *trig = zbus_chan_const_msg(chan);

	if (trig->source == TRIGGER_SOURCE_TIMER) {
		atomic_inc(&timer_trigger_count);
	}
}

ZBUS_LISTENER_DEFINE(test_trigger_listener, test_trigger_cb);

/* ── Suite setup / teardown ─────────────────────────────────────────────── */

static void *suite_setup(void)
{
	/* Subscribe test listener to sensor_event_chan. */
	int rc = zbus_chan_add_obs(&sensor_event_chan, &test_event_listener, K_NO_WAIT);
	zassert_ok(rc, "Failed to add event observer: %d", rc);

	/* Subscribe trigger counter to sensor_trigger_chan. */
	rc = zbus_chan_add_obs(&sensor_trigger_chan, &test_trigger_listener, K_NO_WAIT);
	zassert_ok(rc, "Failed to add trigger observer: %d", rc);
	return NULL;
}

ZTEST_SUITE(fake_sensors_suite, NULL, suite_setup, NULL, NULL, NULL);

/* ── Test cases ──────────────────────────────────────────────────────────── */

/**
 * @brief At least one fake_sensor_entry must exist in the iterable section.
 *
 * The DT overlay defines two nodes (temperature + humidity), so the count
 * must be >= 1. The exact count depends on the overlay used.
 */
ZTEST(fake_sensors_suite, test_fake_sensor_count)
{
	int count = 0;

	STRUCT_SECTION_FOREACH(fake_sensor_entry, entry)
	{
		ARG_UNUSED(entry);
		count++;
	}

	zassert_true(count > 0, "STRUCT_SECTION_COUNT(fake_sensor_entry) == 0; "
				"no fake sensors found — check DT overlay");
}

/**
 * @brief Publishing a broadcast trigger must produce at least one event on
 *        sensor_event_chan within 1 second.
 *
 * Steps:
 *   1. Drain the semaphore.
 *   2. Publish a TRIGGER_SOURCE_TIMER broadcast.
 *   3. Wait up to 1 s for the semaphore.
 *   4. Verify the received event has a valid uid and type.
 */
ZTEST(fake_sensors_suite, test_trigger_produces_event)
{
	/* Drain any leftover events from startup. */
	k_sem_reset(&event_received_sem);

	struct sensor_trigger_event trig = {
		.source = TRIGGER_SOURCE_TIMER,
		.target_uid = 0,
	};

	int rc = zbus_chan_pub(&sensor_trigger_chan, &trig, K_MSEC(100));

	zassert_ok(rc, "Failed to publish trigger: %d", rc);

	/* Wait up to 1 s for an event to arrive. */
	rc = k_sem_take(&event_received_sem, K_SECONDS(1));
	zassert_ok(rc, "No sensor event received within 1 s after trigger publish");

	/* Basic sanity on the received event. */
	zassert_true(last_event.sensor_uid != 0, "Received event has sensor_uid == 0");
	zassert_true(last_event.type == SENSOR_TYPE_TEMPERATURE ||
			     last_event.type == SENSOR_TYPE_HUMIDITY,
		     "Received event has unexpected type %d", last_event.type);
}

/**
 * @brief Auto-publish at 50 ms must publish timer triggers from the workqueue,
 *        and stop publishing once disabled.
 *
 * Steps:
 *   1. Enable auto-publish at 50 ms and sleep 250 ms.
 *   2. Expect at least 2 TRIGGER_SOURCE_TIMER events.
 *   3. Disable auto-publish, sleep 150 ms, snapshot the count.
 *   4. Sleep another 150 ms and expect no further increase.
 */
ZTEST(fake_sensors_suite, test_auto_publish_enable_disable)
{
	fake_sensors_set_auto_publish_ms(50);
	k_sleep(K_MSEC(250));

	int enabled_count = atomic_get(&timer_trigger_count);

	zassert_true(enabled_count >= 2, "Expected >= 2 timer triggers while enabled, got %d",
		     enabled_count);

	fake_sensors_set_auto_publish_ms(0);
	k_sleep(K_MSEC(150));

	int disabled_count = atomic_get(&timer_trigger_count);

	k_sleep(K_MSEC(150));

	zassert_equal(disabled_count, atomic_get(&timer_trigger_count),
		      "Timer triggers still arriving after auto-publish disabled");
}
```
