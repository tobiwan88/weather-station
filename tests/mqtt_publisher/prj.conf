## CMakeLists.txt
```
# SPDX-License-Identifier: Apache-2.0

cmake_minimum_required(VERSION 3.20.0)

find_package(Zephyr REQUIRED HINTS $ENV{ZEPHYR_BASE})
project(test_mqtt_publisher)

target_sources(app PRIVATE src/main.c)

# Expose the internal format header so tests can call helpers directly.
target_include_directories(
  app PRIVATE ${CMAKE_SOURCE_DIR}/../../lib/mqtt_publisher/src)
```

## prj.conf
```kconfig
CONFIG_ZBUS=y
CONFIG_ZBUS_CHANNEL_NAME=y
CONFIG_ZBUS_OBSERVER_NAME=y
CONFIG_ZBUS_RUNTIME_OBSERVERS=y
CONFIG_ZTEST=y

CONFIG_SENSOR_EVENT=y
CONFIG_SENSOR_TRIGGER=y
CONFIG_SENSOR_REGISTRY=y
CONFIG_SENSOR_REGISTRY_USER_META=y
CONFIG_FAKE_SENSORS=y
CONFIG_FAKE_TEMPERATURE_UID_BASE=0x0201
CONFIG_FAKE_HUMIDITY_UID_BASE=0x0202

CONFIG_MQTT_PUBLISHER=y
CONFIG_MQTT_LIB=y
CONFIG_MQTT_PUBLISHER_GATEWAY_NAME="testgw"
CONFIG_MQTT_PUBLISHER_BROKER_HOST="127.0.0.1"
CONFIG_MQTT_PUBLISHER_BROKER_PORT=1883

# Networking required by MQTT_LIB
CONFIG_NETWORKING=y
CONFIG_NET_IPV4=y
CONFIG_NET_UDP=y
CONFIG_NET_SOCKETS=y
CONFIG_NET_SOCKETS_OFFLOAD=y
CONFIG_NET_NATIVE_OFFLOADED_SOCKETS=y
CONFIG_HEAP_MEM_POOL_SIZE=32768
CONFIG_NET_IPV6_DAD=n

CONFIG_DNS_RESOLVER=y

CONFIG_SETTINGS=y
CONFIG_SETTINGS_RUNTIME=y
CONFIG_CONFIG_CMD=y
```

## boards/native_sim_native_64.overlay
```dts
/*
 * SPDX-License-Identifier: Apache-2.0
 *
 * DT overlay for mqtt_publisher tests.
 * Provides one temperature and one humidity fake sensor so the
 * trigger-integration tests can receive events on sensor_event_chan.
 */

/ {
	fake_temp_pub_test: fake-temp-pub-test {
		compatible = "fake,temperature";
		initial-value-mdegc = <23000>;
		status = "okay";
	};

	fake_hum_pub_test: fake-hum-pub-test {
		compatible = "fake,humidity";
		initial-value-mpct = <60000>;
		status = "okay";
	};
};
```

## src/main.c
```c
/* SPDX-License-Identifier: Apache-2.0 */
/**
 * @file main.c (tests/mqtt_publisher)
 * @brief Tests for the mqtt_publisher library.
 *
 * Two suites:
 *
 *   format_suite — unit tests for the pure topic/payload helpers in
 *     mqtt_publisher_format.c.  No MQTT broker, no sensor_registry, no RTOS
 *     state needed.
 *
 *   integration_suite — verifies that a sensor_event_chan publish reaches the
 *     publisher's internal queue.  Uses two fake sensor DT nodes
 *     (0x0201 temperature, 0x0202 humidity) from the DT overlay and calls
 *     mqtt_publisher_queue_used() to check without a live broker.
 */

#include <math.h>
#include <string.h>

#include <zephyr/kernel.h>
#include <zephyr/zbus/zbus.h>
#include <zephyr/ztest.h>

#include <mqtt_publisher/mqtt_publisher.h>
#include <sensor_event/sensor_event.h>
#include <sensor_trigger/sensor_trigger.h>

/* Internal format helpers (src/ is added to include path in CMakeLists). */
#include "mqtt_publisher_format.h"

/* ============================================================================
 * Suite 1: format unit tests
 * ============================================================================ */

ZTEST_SUITE(format_suite, NULL, NULL, NULL, NULL, NULL);

/* --------------------------------------------------------------------------
 * type_to_topic_str
 * -------------------------------------------------------------------------- */

ZTEST(format_suite, test_topic_str_temperature)
{
	zassert_str_equal(mqtt_publisher_type_to_topic_str(SENSOR_TYPE_TEMPERATURE), "temperature",
			  "TEMPERATURE topic str mismatch");
}

ZTEST(format_suite, test_topic_str_humidity)
{
	zassert_str_equal(mqtt_publisher_type_to_topic_str(SENSOR_TYPE_HUMIDITY), "humidity",
			  "HUMIDITY topic str mismatch");
}

ZTEST(format_suite, test_topic_str_pressure)
{
	zassert_str_equal(mqtt_publisher_type_to_topic_str(SENSOR_TYPE_PRESSURE), "pressure",
			  "PRESSURE topic str mismatch");
}

ZTEST(format_suite, test_topic_str_co2)
{
	zassert_str_equal(mqtt_publisher_type_to_topic_str(SENSOR_TYPE_CO2), "co2",
			  "CO2 topic str mismatch");
}

ZTEST(format_suite, test_topic_str_battery_mv)
{
	zassert_str_equal(mqtt_publisher_type_to_topic_str(SENSOR_TYPE_BATTERY_MV), "battery_mv",
			  "BATTERY_MV topic str mismatch");
}

/* --------------------------------------------------------------------------
 * sensor_type_to_unit (from sensor_event lib)
 * -------------------------------------------------------------------------- */

ZTEST(format_suite, test_unit_temperature)
{
	/* °C is encoded as UTF-8 \xc2\xb0\x43 */
	const char *u = sensor_type_to_unit(SENSOR_TYPE_TEMPERATURE);

	zassert_not_null(u, "unit must not be NULL");
	zassert_true(strlen(u) > 0, "temperature unit must not be empty");
	/* Verify the degree symbol is present (UTF-8 0xC2 0xB0) */
	zassert_equal((unsigned char)u[0], 0xC2u,
		      "temperature unit first byte expected 0xC2, got 0x%02X", (unsigned char)u[0]);
}

ZTEST(format_suite, test_unit_humidity)
{
	zassert_str_equal(sensor_type_to_unit(SENSOR_TYPE_HUMIDITY), "%", "HUMIDITY unit mismatch");
}

ZTEST(format_suite, test_unit_pressure)
{
	zassert_str_equal(sensor_type_to_unit(SENSOR_TYPE_PRESSURE), "hPa",
			  "PRESSURE unit mismatch");
}

ZTEST(format_suite, test_unit_co2)
{
	zassert_str_equal(sensor_type_to_unit(SENSOR_TYPE_CO2), "ppm", "CO2 unit mismatch");
}

ZTEST(format_suite, test_unit_battery_mv)
{
	zassert_str_equal(sensor_type_to_unit(SENSOR_TYPE_BATTERY_MV), "mV",
			  "BATTERY_MV unit mismatch");
}

/* --------------------------------------------------------------------------
 * build_topic
 * -------------------------------------------------------------------------- */

ZTEST(format_suite, test_topic_normal)
{
	char buf[128];

	mqtt_publisher_build_topic("gw", "living-room", "dht22", SENSOR_TYPE_TEMPERATURE, buf,
				   sizeof(buf));

	zassert_str_equal(buf, "gw/living-room/dht22/temperature", "unexpected topic: '%s'", buf);
}

ZTEST(format_suite, test_topic_null_location_fallback)
{
	char buf[128];

	mqtt_publisher_build_topic("gw", NULL, "sensor1", SENSOR_TYPE_HUMIDITY, buf, sizeof(buf));

	zassert_str_equal(buf, "gw/unknown/sensor1/humidity",
			  "NULL location should produce 'unknown', got: '%s'", buf);
}

ZTEST(format_suite, test_topic_empty_location_fallback)
{
	char buf[128];

	mqtt_publisher_build_topic("gw", "", "sensor1", SENSOR_TYPE_HUMIDITY, buf, sizeof(buf));

	zassert_str_equal(buf, "gw/unknown/sensor1/humidity",
			  "empty location should produce 'unknown', got: '%s'", buf);
}

ZTEST(format_suite, test_topic_null_name_fallback)
{
	char buf[128];

	mqtt_publisher_build_topic("gw", "kitchen", NULL, SENSOR_TYPE_TEMPERATURE, buf,
				   sizeof(buf));

	zassert_str_equal(buf, "gw/kitchen/unknown/temperature",
			  "NULL name should produce 'unknown', got: '%s'", buf);
}

ZTEST(format_suite, test_topic_empty_name_fallback)
{
	char buf[128];

	mqtt_publisher_build_topic("gw", "kitchen", "", SENSOR_TYPE_TEMPERATURE, buf, sizeof(buf));

	zassert_str_equal(buf, "gw/kitchen/unknown/temperature",
			  "empty name should produce 'unknown', got: '%s'", buf);
}

ZTEST(format_suite, test_topic_no_double_slash)
{
	char buf[128];

	mqtt_publisher_build_topic("weather", "office", "bme280", SENSOR_TYPE_PRESSURE, buf,
				   sizeof(buf));

	zassert_is_null(strstr(buf, "//"), "topic must not contain '//': '%s'", buf);
}

/* --------------------------------------------------------------------------
 * build_payload
 * -------------------------------------------------------------------------- */

ZTEST(format_suite, test_payload_keys_present)
{
	char buf[256];
	int32_t q31 = temperature_c_to_q31(22.0);

	int len = mqtt_publisher_build_payload(1000000LL, SENSOR_TYPE_TEMPERATURE, q31, buf,
					       sizeof(buf));

	zassert_true(len > 0, "build_payload returned %d", len);
	zassert_not_null(strstr(buf, "\"time\""), "payload missing 'time' key");
	zassert_not_null(strstr(buf, "\"value\""), "payload missing 'value' key");
	zassert_not_null(strstr(buf, "\"unit\""), "payload missing 'unit' key");
}

ZTEST(format_suite, test_payload_epoch_seconds)
{
	char buf[256];
	int32_t q31 = temperature_c_to_q31(0.0);

	mqtt_publisher_build_payload(1743948000LL, SENSOR_TYPE_TEMPERATURE, q31, buf, sizeof(buf));

	/* The epoch value must appear literally in the payload. */
	zassert_not_null(strstr(buf, "1743948000"), "epoch_s not found in payload: '%s'", buf);
}

ZTEST(format_suite, test_payload_temperature_value)
{
	char buf[256];
	const double input_c = 23.45;
	int32_t q31 = temperature_c_to_q31(input_c);

	mqtt_publisher_build_payload(0LL, SENSOR_TYPE_TEMPERATURE, q31, buf, sizeof(buf));

	/* Value should be 23.45 — accept ±0.1 °C rounding in snprintf("%.2f") */
	zassert_not_null(strstr(buf, "23.4"), "temperature value not found in payload: '%s'", buf);
}

ZTEST(format_suite, test_payload_humidity_value)
{
	char buf[256];
	const double input_pct = 65.2;
	int32_t q31 = humidity_pct_to_q31(input_pct);

	mqtt_publisher_build_payload(0LL, SENSOR_TYPE_HUMIDITY, q31, buf, sizeof(buf));

	zassert_not_null(strstr(buf, "65."), "humidity value not found in payload: '%s'", buf);
}

ZTEST(format_suite, test_payload_is_valid_json_start_end)
{
	char buf[256];

	mqtt_publisher_build_payload(0LL, SENSOR_TYPE_HUMIDITY, humidity_pct_to_q31(50.0), buf,
				     sizeof(buf));

	zassert_equal(buf[0], '{', "payload must start with '{'");
	zassert_equal(buf[strlen(buf) - 1], '}', "payload must end with '}'");
}

/* ============================================================================
 * Suite 2: config API unit tests
 * ============================================================================ */

ZTEST_SUITE(config_suite, NULL, NULL, NULL, NULL, NULL);

ZTEST(config_suite, test_get_config_defaults)
{
	struct mqtt_publisher_config cfg;

	mqtt_publisher_get_config(&cfg);

	zassert_true(cfg.enabled, "MQTT should be enabled by default");
	zassert_str_equal(cfg.host, "127.0.0.1", "host mismatch");
	zassert_equal(cfg.port, 1883, "port mismatch");
	zassert_str_equal(cfg.gateway_name, "testgw", "gateway name mismatch");
}

ZTEST(config_suite, test_set_enabled_disable)
{
	struct mqtt_publisher_config cfg;

	zassert_ok(mqtt_publisher_set_enabled(false), "disable must succeed");
	mqtt_publisher_get_config(&cfg);
	zassert_false(cfg.enabled, "MQTT should be disabled after set_enabled(false)");

	zassert_ok(mqtt_publisher_set_enabled(true), "enable must succeed");
	mqtt_publisher_get_config(&cfg);
	zassert_true(cfg.enabled, "MQTT should be enabled after set_enabled(true)");
}

ZTEST(config_suite, test_set_broker)
{
	struct mqtt_publisher_config cfg;

	cfg.port = 9876;
	strncpy(cfg.host, "broker.test", sizeof(cfg.host) - 1);
	cfg.host[sizeof(cfg.host) - 1] = '\0';
	cfg.keepalive = 120;

	zassert_ok(mqtt_publisher_set_broker(&cfg), "set_broker must succeed");

	mqtt_publisher_get_config(&cfg);
	zassert_str_equal(cfg.host, "broker.test", "host not updated");
	zassert_equal(cfg.port, 9876, "port not updated");
	zassert_equal(cfg.keepalive, 120, "keepalive not updated");

	/* Restore defaults. */
	strncpy(cfg.host, "127.0.0.1", sizeof(cfg.host) - 1);
	cfg.host[sizeof(cfg.host) - 1] = '\0';
	cfg.port = 1883;
	cfg.keepalive = 60;
	mqtt_publisher_set_broker(&cfg);
}

ZTEST(config_suite, test_set_auth)
{
	struct mqtt_publisher_config cfg;

	zassert_ok(mqtt_publisher_set_auth("testuser", "testpass"), "set_auth must succeed");

	mqtt_publisher_get_config(&cfg);
	zassert_str_equal(cfg.username, "testuser", "username not updated");

	/* Restore defaults. */
	zassert_ok(mqtt_publisher_set_auth("", ""), "clear auth must succeed");
	mqtt_publisher_get_config(&cfg);
	zassert_str_equal(cfg.username, "", "username not cleared");
}

ZTEST(config_suite, test_set_gateway_name)
{
	struct mqtt_publisher_config cfg;

	zassert_ok(mqtt_publisher_set_gateway_name("newgw"), "set_gateway_name must succeed");

	mqtt_publisher_get_config(&cfg);
	zassert_str_equal(cfg.gateway_name, "newgw", "gateway_name not updated");

	/* Restore default. */
	zassert_ok(mqtt_publisher_set_gateway_name("testgw"), "restore gateway_name must succeed");
}

ZTEST(config_suite, test_set_broker_null_rejected)
{
	zassert_equal(mqtt_publisher_set_broker(NULL), -EINVAL, "null broker must be rejected");
}

ZTEST(config_suite, test_set_auth_null_rejected)
{
	zassert_equal(mqtt_publisher_set_auth(NULL, "pass"), -EINVAL, "null user must be rejected");
	zassert_equal(mqtt_publisher_set_auth("user", NULL), -EINVAL, "null pass must be rejected");
}

ZTEST(config_suite, test_set_gateway_null_rejected)
{
	zassert_equal(mqtt_publisher_set_gateway_name(NULL), -EINVAL,
		      "null gateway must be rejected");
}

ZTEST(config_suite, test_set_enabled_idempotent)
{
	zassert_ok(mqtt_publisher_set_enabled(true), "enable must succeed");
	zassert_ok(mqtt_publisher_set_enabled(true), "re-enable must succeed");

	zassert_ok(mqtt_publisher_set_enabled(false), "disable must succeed");
	zassert_ok(mqtt_publisher_set_enabled(false), "re-disable must succeed");

	/* Restore enabled state. */
	zassert_ok(mqtt_publisher_set_enabled(true), "restore must succeed");
}

/* ============================================================================
 * Suite 3: integration — zbus trigger → queue enqueue
 * ============================================================================ */

ZTEST_SUITE(integration_suite, NULL, NULL, NULL, NULL, NULL);

/**
 * @brief Publishing on sensor_trigger_chan must enqueue items in the
 *        mqtt_publisher's internal queue within 500 ms.
 *
 * Two fake sensor DT nodes (0x0201, 0x0202) from the overlay respond to the
 * broadcast trigger and emit events on sensor_event_chan.  The publisher's
 * zbus listener picks them up and enqueues them.  We check
 * mqtt_publisher_queue_used() > 0 without needing a live broker.
 *
 * NOTE: the MQTT thread will attempt to connect (and fail — no broker in CI).
 * Events are enqueued regardless; they will be dropped when the thread
 * re-enters the reconnect loop.  This test only validates the listener path.
 */
ZTEST(integration_suite, test_trigger_enqueues_events)
{
	/* Drain any events queued from startup auto-publish. */
	k_sleep(K_MSEC(100));

	/* Record baseline. */
	int before = mqtt_publisher_queue_used();

	/* Publish a broadcast trigger — both fake sensors will respond. */
	struct sensor_trigger_event trig = {
		.source = TRIGGER_SOURCE_TIMER,
		.target_uid = 0,
	};

	int rc = zbus_chan_pub(&sensor_trigger_chan, &trig, K_MSEC(100));

	zassert_ok(rc, "Failed to publish trigger: %d", rc);

	/* Give the sensor drivers and zbus dispatch time to run. */
	k_sleep(K_MSEC(200));

	int after = mqtt_publisher_queue_used();

	zassert_true(after > before,
		     "Queue count did not increase after trigger "
		     "(before=%d after=%d) — listener may not be registered",
		     before, after);
}

/**
 * @brief When MQTT is disabled, triggering sensors must NOT enqueue events.
 */
ZTEST(integration_suite, test_disabled_drops_events)
{
	/* Drain any events from startup. */
	k_sleep(K_MSEC(100));

	/* Disable MQTT publisher. */
	zassert_ok(mqtt_publisher_set_enabled(false), "disable must succeed");
	k_sleep(K_MSEC(50));

	int before = mqtt_publisher_queue_used();

	/* Publish a broadcast trigger. */
	struct sensor_trigger_event trig = {
		.source = TRIGGER_SOURCE_TIMER,
		.target_uid = 0,
	};

	int rc = zbus_chan_pub(&sensor_trigger_chan, &trig, K_MSEC(100));

	zassert_ok(rc, "Failed to publish trigger: %d", rc);

	/* Give time for any potential enqueue. */
	k_sleep(K_MSEC(200));

	int after = mqtt_publisher_queue_used();

	zassert_equal(after, before,
		      "Queue must not grow when MQTT is disabled "
		      "(before=%d after=%d)",
		      before, after);

	/* Restore enabled state. */
	zassert_ok(mqtt_publisher_set_enabled(true), "restore must succeed");
}
```
